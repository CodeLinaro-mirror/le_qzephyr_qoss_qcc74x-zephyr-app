## CMakeLists.txt
```
# Copyright (c) Qualcomm Technologies, Inc. and/or its subsidiaries
# SPDX-License-Identifier: BSD-3-Clause

cmake_minimum_required(VERSION 3.20.0)

find_package(Zephyr REQUIRED HINTS $ENV{ZEPHYR_BASE})
project(ble_prov_wifi)

target_sources(app PRIVATE
	src/main.c
	src/qcc74xsync_ble.c
	src/qcc74xsync_ble_app.c
	src/transfer.c
	src/payload.c
	src/encrypt_layer.c
)
```

## prj.conf
```kconfig
# Common networking and QCC74x Wi-Fi baseline.
CONFIG_NETWORKING=y
CONFIG_WIFI=y
CONFIG_WIFI_QCC74X=y
CONFIG_QC7XX_WIFI_STA_AUTO_DHCPV4=y
CONFIG_NET_IPV4=y
CONFIG_NET_DHCPV4=y
CONFIG_NET_L2_ETHERNET=y
CONFIG_NET_STATISTICS=y
CONFIG_NET_BUF_POOL_USAGE=y
CONFIG_POSIX_API=y
CONFIG_POSIX_TIMERS=y

# Bluetooth Host over the board's QCC74x HCI/controller interface.
CONFIG_BT=y
CONFIG_BT_PERIPHERAL=y
CONFIG_BT_BROADCASTER=y
CONFIG_BT_GATT_CLIENT=y
CONFIG_BT_DEVICE_NAME="BTBLE-DEV"
CONFIG_BT_SMP=n
CONFIG_BT_SETTINGS=n
CONFIG_BT_HCI_ACL_FLOW_CONTROL=n

# Match the qcc74xsync ATT/GATT transport capacity.
CONFIG_BT_BUF_ACL_TX_SIZE=251
CONFIG_BT_BUF_ACL_RX_SIZE=251
CONFIG_BT_L2CAP_TX_MTU=247

# The QCC74x Wi-Fi integration uses the Ethernet L2/net_if plumbing even
# though the user-facing radio is Wi-Fi.
CONFIG_SHELL=y
CONFIG_NET_L2_WIFI_SHELL=y
CONFIG_THREAD_CUSTOM_DATA=y

CONFIG_MAIN_STACK_SIZE=4096
CONFIG_SYSTEM_WORKQUEUE_STACK_SIZE=6144
CONFIG_HEAP_MEM_POOL_SIZE=32708

CONFIG_MBEDTLS_ECP_NIST_OPTIM=y
CONFIG_PSA_CRYPTO_ENABLE_ALL=y
CONFIG_MBEDTLS_CTR_DRBG_C=y
CONFIG_MBEDTLS_ENTROPY_C=y
CONFIG_MBEDTLS_PSA_CRYPTO_LEGACY_RNG=y

CONFIG_LOG=y
```

## socs/qcc748.conf
```kconfig
# Network management queues used by the QCC74x Wi-Fi driver. Scan results and
# connect/disconnect completions are delivered asynchronously, so the queue
# must absorb events while the protocol thread is handling another request.
CONFIG_NET_MGMT_EVENT_QUEUE_SIZE=16
CONFIG_NET_MGMT_EVENT_QUEUE_TIMEOUT=5000

# Wi-Fi packet processing runs in Zephyr network TX/RX threads. These stack
# sizes are platform requirements rather than the smartconfig protocol thread
# stack defined in main.c.
CONFIG_NET_TX_STACK_SIZE=4096
CONFIG_NET_RX_STACK_SIZE=4096

# IPv6 is not part of this station-provisioning contract; limiting the network
# stack to IPv4 keeps the combined BLE/Wi-Fi image smaller and deterministic.
CONFIG_NET_IPV6=n
```

## src/main.c
```c
/*
 * Copyright (c) Qualcomm Technologies, Inc. and/or its subsidiaries
 * SPDX-License-Identifier: BSD-3-Clause
 */

#include <zephyr/kernel.h>

#include "qcc74xsync_ble.h"

int main(void)
{
	return qcc74xsync_ble_start();
}
```

## src/encrypt_layer.c
```c
/*
 * Copyright (c) Qualcomm Technologies, Inc. and/or its subsidiaries
 * SPDX-License-Identifier: BSD-3-Clause
 */

#include "encrypt_layer.h"

#include <errno.h>
#include <string.h>

#include "payload.h"

int qcc74xsync_encrypt_read(uint8_t packet_type, uint8_t *event_id,
				    uint8_t *dst, uint8_t *dst_len,
				    const uint8_t *src, size_t src_len,
				    bool first, size_t dst_capacity)
{
	/* qcc74xsync reserves nine bytes on the first fragment and one byte on
	 * continuation fragments. These fields are compatibility framing only; the
	 * current implementation does not decrypt or authenticate the payload. */
	if (first) {
		if (src_len < 9U) {
			return -EINVAL;
		}
		src += 9U;
		src_len -= 9U;
	} else {
		if (src_len < 1U) {
			return -EINVAL;
		}
		src++;
		src_len--;
	}

	return qcc74xsync_payload_read(packet_type, event_id, dst, dst_len,
					       src, src_len, dst_capacity);
}

int qcc74xsync_encrypt_write(uint8_t packet_type, uint8_t event_id,
				     uint8_t *dst, uint8_t *dst_len,
				     const uint8_t *src, uint16_t src_len,
				     int16_t remaining, bool first)
{
	uint8_t framing_length = first ? 9U : 1U;

	if (remaining < framing_length) {
		return -EINVAL;
	}

	memset(dst, 0, framing_length);
	*dst_len += framing_length;
	remaining -= framing_length;

	return qcc74xsync_payload_write(packet_type, event_id,
					&dst[framing_length], dst_len, src, src_len,
					remaining);
}
```

## src/encrypt_layer.h
```c
/*
 * Copyright (c) Qualcomm Technologies, Inc. and/or its subsidiaries
 * SPDX-License-Identifier: BSD-3-Clause
 */

#ifndef QCC74XSYNC_ENCRYPT_LAYER_H_
#define QCC74XSYNC_ENCRYPT_LAYER_H_

#include <stdbool.h>
#include <stddef.h>
#include <stdint.h>

int qcc74xsync_encrypt_read(uint8_t packet_type, uint8_t *event_id,
				    uint8_t *dst, uint8_t *dst_len,
				    const uint8_t *src, size_t src_len,
				    bool first, size_t dst_capacity);

int qcc74xsync_encrypt_write(uint8_t packet_type, uint8_t event_id,
				     uint8_t *dst, uint8_t *dst_len,
				     const uint8_t *src, uint16_t src_len,
				     int16_t remaining, bool first);

#endif /* QCC74XSYNC_ENCRYPT_LAYER_H_ */
```

## src/payload.c
```c
/*
 * Copyright (c) Qualcomm Technologies, Inc. and/or its subsidiaries
 * SPDX-License-Identifier: BSD-3-Clause
 */

#include "payload.h"

#include <errno.h>
#include <string.h>

#include <zephyr/sys/util.h>

int qcc74xsync_payload_read(uint8_t packet_type, uint8_t *event_id,
				    uint8_t *dst, uint8_t *dst_len,
				    const uint8_t *src, size_t src_len,
				    size_t dst_capacity)
{
	if (packet_type == QCC74XSYNC_PACKET_CMD) {
		/* The legacy APK can omit the final reserved command byte. */
		if ((src_len != 4U && src_len != 5U) || dst_capacity < 4U) {
			return -EINVAL;
		}

		*dst_len = 4U;
		*event_id = src[0];
		memset(dst, 0, 4U);
		memcpy(dst, &src[1], src_len - 1U);
		return 0;
	}

	if (src_len < 2U || src[0] != src_len - 2U || dst_capacity < src[0]) {
		return -EINVAL;
	}

	*dst_len = src[0];
	*event_id = src[1];
	memcpy(dst, &src[2], *dst_len);
	return 0;
}

int qcc74xsync_payload_write(uint8_t packet_type, uint8_t event_id,
				     uint8_t *dst, uint8_t *dst_len,
				     const uint8_t *src, uint16_t src_len,
				     int16_t remaining)
{
	uint16_t payload_size;

	if (remaining < 0) {
		return -EINVAL;
	}

	if (packet_type == QCC74XSYNC_PACKET_CMD) {
		if (remaining < 5 || src_len < 4U) {
			return -EINVAL;
		}

		dst[0] = event_id;
		memcpy(&dst[1], src, 4U);
		*dst_len += 5U;
		return 4;
	}

	if (remaining < 2) {
		return -EINVAL;
	}

	payload_size = MIN((uint16_t)(remaining - 2), src_len);
	dst[0] = (uint8_t)payload_size;
	dst[1] = event_id;
	memcpy(&dst[2], src, payload_size);
	*dst_len += 2U + payload_size;
	return payload_size;
}
```

## src/payload.h
```c
/*
 * Copyright (c) Qualcomm Technologies, Inc. and/or its subsidiaries
 * SPDX-License-Identifier: BSD-3-Clause
 */

#ifndef QCC74XSYNC_PAYLOAD_H_
#define QCC74XSYNC_PAYLOAD_H_

#include <stddef.h>
#include <stdint.h>

enum qcc74xsync_packet_type {
	QCC74XSYNC_PACKET_CMD = 0U,
	QCC74XSYNC_PACKET_DATA = 1U,
};

int qcc74xsync_payload_read(uint8_t packet_type, uint8_t *event_id,
				    uint8_t *dst, uint8_t *dst_len,
				    const uint8_t *src, size_t src_len,
				    size_t dst_capacity);

int qcc74xsync_payload_write(uint8_t packet_type, uint8_t event_id,
				     uint8_t *dst, uint8_t *dst_len,
				     const uint8_t *src, uint16_t src_len,
				     int16_t remaining);

#endif /* QCC74XSYNC_PAYLOAD_H_ */
```

## src/pro_config.h
```c
/*
 * Copyright (c) Qualcomm Technologies, Inc. and/or its subsidiaries
 * SPDX-License-Identifier: BSD-3-Clause
 */

#ifndef QCC74XSYNC_PRO_CONFIG_H_
#define QCC74XSYNC_PRO_CONFIG_H_

#define QCC74XSYNC_PROTOCOL_TIMEOUT_MS 10000U
#define QCC74XSYNC_PROTOCOL_BUF_SIZE 256U

#endif /* QCC74XSYNC_PRO_CONFIG_H_ */
```

## src/qcc74xsync_ble.c
```c
/*
 * Copyright (c) Qualcomm Technologies, Inc. and/or its subsidiaries
 * SPDX-License-Identifier: BSD-3-Clause
 */

#include "qcc74xsync_ble.h"

#include <errno.h>
#include <stdbool.h>
#include <string.h>

#include <zephyr/bluetooth/bluetooth.h>
#include <zephyr/bluetooth/conn.h>
#include <zephyr/bluetooth/gap.h>
#include <zephyr/bluetooth/gatt.h>
#include <zephyr/kernel.h>
#include <zephyr/sys/printk.h>
#include <zephyr/sys/util.h>

#include "qcc74xsync_ble_app.h"

#define SMARTCONFIG_SERVICE_UUID 0xFFFF
#define SMARTCONFIG_WRITE_UUID 0xFF01
#define SMARTCONFIG_READ_UUID 0xFF02
#define SMARTCONFIG_RX_QUEUE_SIZE 2
#define SMARTCONFIG_PROTOCOL_REVISION "rx-v6"

#define SCB_TRACE(fmt, ...) printk("scbtr|" fmt "\n", ##__VA_ARGS__)

struct smartconfig_rx_packet {
	uint16_t length;
	uint8_t data[QCC74XSYNC_PROTOCOL_BUF_SIZE];
};

static struct bt_uuid_16 smartconfig_service_uuid =
	BT_UUID_INIT_16(SMARTCONFIG_SERVICE_UUID);
static struct bt_uuid_16 smartconfig_write_uuid =
	BT_UUID_INIT_16(SMARTCONFIG_WRITE_UUID);
static struct bt_uuid_16 smartconfig_read_uuid =
	BT_UUID_INIT_16(SMARTCONFIG_READ_UUID);

static struct qcc74xsync_transfer transfer;
static struct bt_conn *current_conn;
static struct bt_gatt_exchange_params exchange_params;

static uint8_t read_value[QCC74XSYNC_PROTOCOL_BUF_SIZE];
static uint16_t read_value_length;
static bool read_waiting_for_ack;
static bool notify_enabled;

K_MSGQ_DEFINE(smartconfig_rx_queue, sizeof(struct smartconfig_rx_packet),
		      SMARTCONFIG_RX_QUEUE_SIZE, 4);
K_THREAD_STACK_DEFINE(smartconfig_thread_stack, 4096);
static struct k_thread smartconfig_thread_data;

static ssize_t smartconfig_read(struct bt_conn *conn,
				const struct bt_gatt_attr *attr, void *buf,
				uint16_t len, uint16_t offset);
static ssize_t smartconfig_write(struct bt_conn *conn,
				 const struct bt_gatt_attr *attr, const void *buf,
				 uint16_t len, uint16_t offset, uint8_t flags);
static void smartconfig_ccc_changed(const struct bt_gatt_attr *attr,
					    uint16_t value);

BT_GATT_SERVICE_DEFINE(smartconfig_service,
	BT_GATT_PRIMARY_SERVICE(&smartconfig_service_uuid.uuid),
	BT_GATT_CHARACTERISTIC(&smartconfig_read_uuid.uuid,
				       BT_GATT_CHRC_READ | BT_GATT_CHRC_NOTIFY,
				       BT_GATT_PERM_READ, smartconfig_read, NULL, NULL),
	BT_GATT_CCC(smartconfig_ccc_changed,
			    BT_GATT_PERM_READ | BT_GATT_PERM_WRITE),
	BT_GATT_CHARACTERISTIC(&smartconfig_write_uuid.uuid,
				       BT_GATT_CHRC_WRITE |
				       BT_GATT_CHRC_WRITE_WITHOUT_RESP,
				       BT_GATT_PERM_WRITE, NULL, smartconfig_write, NULL)
);

static int qcc74xsync_ble_send(void *ctx, const uint8_t *data, size_t length)
{
	int err = 0;

	ARG_UNUSED(ctx);

	if (current_conn == NULL || length > sizeof(read_value)) {
		return -ENOTCONN;
	}

	memcpy(read_value, data, length);
	read_value_length = length;
	read_waiting_for_ack = !notify_enabled;
	SCB_TRACE("GATT_TX|len=%u|notify=%u", (unsigned int)length,
		  notify_enabled ? 1U : 0U);

	if (notify_enabled) {
		err = bt_gatt_notify(current_conn, &smartconfig_service.attrs[2],
				     data, length);
		if (err != 0) {
			return err;
		}
		return qcc74xsync_transfer_ack(&transfer);
	}

	return 0;
}

static ssize_t smartconfig_read(struct bt_conn *conn,
				const struct bt_gatt_attr *attr, void *buf,
				uint16_t len, uint16_t offset)
{
	uint8_t value[QCC74XSYNC_PROTOCOL_BUF_SIZE];
	uint16_t value_length;
	ssize_t ret;

	if (read_value_length == 0U) {
		return BT_GATT_ERR(BT_ATT_ERR_INVALID_PDU);
	}

	value_length = read_value_length;
	memcpy(value, read_value, value_length);
	read_value_length = 0U;
	if (read_waiting_for_ack) {
		read_waiting_for_ack = false;
		SCB_TRACE("GATT_ACK|source=read");
		(void)qcc74xsync_transfer_ack(&transfer);
	}
	SCB_TRACE("GATT_RD|offset=%u|request=%u|value=%u", offset, len,
		  value_length);
	ret = bt_gatt_attr_read(conn, attr, buf, len, offset, value,
				value_length);
	return ret;
}

static ssize_t smartconfig_write(struct bt_conn *conn,
				 const struct bt_gatt_attr *attr, const void *buf,
				 uint16_t len, uint16_t offset, uint8_t flags)
{
	struct smartconfig_rx_packet packet;

	ARG_UNUSED(attr);
	ARG_UNUSED(flags);

	if (offset != 0U || len > sizeof(packet.data)) {
		return BT_GATT_ERR(BT_ATT_ERR_INVALID_ATTRIBUTE_LEN);
	}

	if (current_conn != conn) {
		if (current_conn != NULL) {
			bt_conn_unref(current_conn);
		}
		current_conn = bt_conn_ref(conn);
	}

	packet.length = len;
	memcpy(packet.data, buf, len);
	SCB_TRACE("GATT_WR|len=%u", len);
	if (k_msgq_put(&smartconfig_rx_queue, &packet, K_NO_WAIT) != 0) {
		return BT_GATT_ERR(BT_ATT_ERR_INSUFFICIENT_RESOURCES);
	}

	return len;
}

static void smartconfig_ccc_changed(const struct bt_gatt_attr *attr,
					    uint16_t value)
{
	ARG_UNUSED(attr);
	notify_enabled = value == BT_GATT_CCC_NOTIFY;
	printk("smartconfig_ble: notifications %s\n",
	       notify_enabled ? "enabled" : "disabled");
}

static void exchange_complete(struct bt_conn *conn, uint8_t err,
				      struct bt_gatt_exchange_params *params)
{
	ARG_UNUSED(conn);
	ARG_UNUSED(params);
	printk("smartconfig_ble: MTU exchange %s\n",
	       err == 0U ? "successful" : "failed");
}

static int qcc74xsync_ble_start_advertising(void);

static void connected(struct bt_conn *conn, uint8_t err)
{
	if (err != 0U) {
		printk("smartconfig_ble: connection failed (%u)\n", err);
		return;
	}

	if (current_conn != NULL) {
		bt_conn_unref(current_conn);
	}
	current_conn = bt_conn_ref(conn);
	exchange_params.func = exchange_complete;
	(void)bt_gatt_exchange_mtu(conn, &exchange_params);
	printk("smartconfig_ble: connected\n");
}

static void disconnected(struct bt_conn *conn, uint8_t reason)
{
	if (current_conn == conn) {
		bt_conn_unref(current_conn);
		current_conn = NULL;
	}
	read_value_length = 0U;
	read_waiting_for_ack = false;
	qcc74xsync_transfer_reset(&transfer);
	printk("smartconfig_ble: disconnected (%u)\n", reason);
	if (qcc74xsync_ble_start_advertising() == 0) {
		printk("smartconfig_ble: advertising restarted\n");
	}
}

static struct bt_conn_cb connection_callbacks = {
	.connected = connected,
	.disconnected = disconnected,
};

static const uint8_t manufacturer_data[] = "QCC743";
static const uint8_t device_name[] = "BTBLE-DEV";
static const struct bt_data advertising_data[] = {
	BT_DATA_BYTES(BT_DATA_FLAGS, BT_LE_AD_GENERAL | BT_LE_AD_NO_BREDR),
};
static const struct bt_data scan_response_data[] = {
	BT_DATA(BT_DATA_MANUFACTURER_DATA, manufacturer_data,
		 sizeof(manufacturer_data) - 1U),
	BT_DATA(BT_DATA_NAME_COMPLETE, device_name, sizeof(device_name) - 1U),
};
static const struct bt_le_adv_param advertising_param = {
	.options = BT_GAP_ADV_PROP_CONNECTABLE | BT_LE_ADV_OPT_SCANNABLE,
	.interval_min = BT_GAP_ADV_FAST_INT_MIN_2,
	.interval_max = BT_GAP_ADV_FAST_INT_MAX_2,
};

static int qcc74xsync_ble_start_advertising(void)
{
	return bt_le_adv_start(&advertising_param, advertising_data,
				       ARRAY_SIZE(advertising_data), scan_response_data,
				       ARRAY_SIZE(scan_response_data));
}

static void bluetooth_ready(int err)
{
	if (err != 0) {
		printk("smartconfig_ble: Bluetooth init failed (%d)\n", err);
		return;
	}

	bt_conn_cb_register(&connection_callbacks);
	err = qcc74xsync_ble_start_advertising();
	if (err != 0) {
		printk("smartconfig_ble: advertising failed (%d)\n", err);
		return;
	}

	printk("smartconfig_ble: advertising as BTBLE-DEV\n");
	printk("smartconfig_ble: GATT 0xFFFF / read 0xFF02 / write 0xFF01\n");
}

static void qcc74xsync_protocol_thread(void *p1, void *p2, void *p3)
{
	struct smartconfig_rx_packet packet;
	uint16_t mtu;

	ARG_UNUSED(p1);
	ARG_UNUSED(p2);
	ARG_UNUSED(p3);

	while (true) {
		if (k_msgq_get(&smartconfig_rx_queue, &packet, K_FOREVER) != 0) {
			continue;
		}

		mtu = current_conn != NULL ? bt_gatt_get_mtu(current_conn) - 3U : 20U;
		(void)qcc74xsync_transfer_receive(&transfer, packet.data,
						  packet.length, mtu);
	}
}

int qcc74xsync_ble_start(void)
{
	int err;

	printk("smartconfig_ble: protocol revision %s\n",
	       SMARTCONFIG_PROTOCOL_REVISION);
	err = qcc74xsync_transfer_init(&transfer, qcc74xsync_ble_send,
					qcc74xsync_ble_app_event, NULL);
	if (err != 0) {
		return err;
	}
	err = qcc74xsync_ble_app_init(&transfer);
	if (err != 0) {
		return err;
	}

	k_thread_create(&smartconfig_thread_data, smartconfig_thread_stack,
				K_THREAD_STACK_SIZEOF(smartconfig_thread_stack),
				qcc74xsync_protocol_thread, NULL, NULL, NULL, 5, 0,
				K_NO_WAIT);

	err = bt_enable(bluetooth_ready);
	if (err != 0) {
		return err;
	}

	while (true) {
		k_sleep(K_SECONDS(1));
	}
}
```

## src/qcc74xsync_ble.h
```c
/*
 * Copyright (c) Qualcomm Technologies, Inc. and/or its subsidiaries
 * SPDX-License-Identifier: BSD-3-Clause
 */

#ifndef QCC74XSYNC_BLE_H_
#define QCC74XSYNC_BLE_H_

int qcc74xsync_ble_start(void);

#endif /* QCC74XSYNC_BLE_H_ */
```

## src/qcc74xsync_ble_app.c
```c
/*
 * Copyright (c) Qualcomm Technologies, Inc. and/or its subsidiaries
 * SPDX-License-Identifier: BSD-3-Clause
 */

#include "qcc74xsync_ble_app.h"

#include <errno.h>
#include <stdbool.h>
#include <string.h>

#include <zephyr/kernel.h>
#include <zephyr/net/net_if.h>
#include <zephyr/net/net_ip.h>
#include <zephyr/net/net_mgmt.h>
#include <zephyr/net/wifi_mgmt.h>
#include <zephyr/sys/printk.h>
#include <zephyr/sys/util.h>

#define SMARTCONFIG_WIFI_SCAN_MAX 50U
#define SMARTCONFIG_WIFI_PSK_MAX 64U

#define SMARTCONFIG_WIFI_EVENT_MASK \
	(NET_EVENT_WIFI_SCAN_RESULT | NET_EVENT_WIFI_SCAN_DONE | \
	 NET_EVENT_WIFI_CONNECT_RESULT | NET_EVENT_WIFI_DISCONNECT_RESULT)

#define SCB_TRACE(fmt, ...) printk("scbtr|" fmt "\n", ##__VA_ARGS__)

struct qcc74xsync_wifi_scan_item {
	uint8_t ssid[WIFI_SSID_MAX_LEN + 1U];
	uint8_t ssid_length;
	uint8_t bssid[WIFI_MAC_ADDR_LEN];
	uint8_t channel;
	uint8_t auth;
	int8_t rssi;
};

static struct qcc74xsync_transfer *transfer;
static struct net_if *wifi_iface;
static struct net_mgmt_event_callback wifi_mgmt_callback;

static uint8_t wifi_ssid[WIFI_SSID_MAX_LEN + 1U];
static uint8_t wifi_ssid_length;
static uint8_t wifi_password[SMARTCONFIG_WIFI_PSK_MAX + 1U];
static uint8_t wifi_password_length;
static struct qcc74xsync_wifi_scan_item wifi_scan_items[SMARTCONFIG_WIFI_SCAN_MAX];
static uint8_t wifi_scan_read_index;
static uint8_t wifi_scan_write_index;
static bool wifi_scan_active;
K_MUTEX_DEFINE(wifi_cache_lock);

static uint8_t wifi_auth_from_security(enum wifi_security_type security)
{
	switch (security) {
	case WIFI_SECURITY_TYPE_NONE:
		return 0U;
	case WIFI_SECURITY_TYPE_WEP:
	case WIFI_SECURITY_TYPE_WEP_OPEN:
	case WIFI_SECURITY_TYPE_WEP_SHARED:
		return 1U;
	case WIFI_SECURITY_TYPE_WPA_PSK:
	case WIFI_SECURITY_TYPE_PSK:
	case WIFI_SECURITY_TYPE_PSK_SHA256:
	case WIFI_SECURITY_TYPE_WPA_AUTO_PERSONAL:
	case WIFI_SECURITY_TYPE_SAE:
	case WIFI_SECURITY_TYPE_SAE_H2E:
	case WIFI_SECURITY_TYPE_SAE_AUTO:
		return 2U;
	default:
		return 0xffU;
	}
}

static int json_escape(char *dst, size_t dst_size, const uint8_t *src,
			       size_t src_length)
{
	static const char hex[] = "0123456789abcdef";
	size_t used = 0U;

	if (dst == NULL || dst_size == 0U || (src == NULL && src_length != 0U)) {
		return -EINVAL;
	}

	for (size_t i = 0U; i < src_length; i++) {
		uint8_t c = src[i];

		if (c == '"' || c == '\\') {
			if (used + 2U >= dst_size) {
				return -ENOSPC;
			}
			dst[used++] = '\\';
			dst[used++] = c;
		} else if (c < 0x20U) {
			if (used + 6U >= dst_size) {
				return -ENOSPC;
			}
			dst[used++] = '\\';
			dst[used++] = 'u';
			dst[used++] = '0';
			dst[used++] = '0';
			dst[used++] = hex[c >> 4];
			dst[used++] = hex[c & 0x0fU];
		} else {
			if (used + 1U >= dst_size) {
				return -ENOSPC;
			}
			dst[used++] = c;
		}
	}

	dst[used] = '\0';
	return 0;
}

static int wifi_set_credential(uint8_t *dst, uint8_t *dst_length,
			       size_t dst_size, const uint8_t *src, size_t src_length)
{
	if (dst == NULL || dst_length == NULL || src_length > dst_size ||
	    (src == NULL && src_length != 0U)) {
		return -EINVAL;
	}

	memset(dst, 0, dst_size);
	if (src_length != 0U) {
		memcpy(dst, src, src_length);
	}
	*dst_length = src_length;
	return 0;
}

static int wifi_start_scan(void)
{
	struct wifi_scan_params params = { 0 };
	int ret;

	if (wifi_iface == NULL) {
		return -ENODEV;
	}

	k_mutex_lock(&wifi_cache_lock, K_FOREVER);
	wifi_scan_read_index = 0U;
	wifi_scan_write_index = 0U;
	wifi_scan_active = true;
	memset(wifi_scan_items, 0, sizeof(wifi_scan_items));
	k_mutex_unlock(&wifi_cache_lock);

	ret = net_mgmt(NET_REQUEST_WIFI_SCAN, wifi_iface, &params, sizeof(params));
	SCB_TRACE("WIFI_SCAN_START|ret=%d|admin=%u", ret,
		  net_if_is_admin_up(wifi_iface) ? 1U : 0U);
	if (ret != 0) {
		k_mutex_lock(&wifi_cache_lock, K_FOREVER);
		wifi_scan_active = false;
		k_mutex_unlock(&wifi_cache_lock);
	}

	return ret;
}

static int wifi_connect(void)
{
	struct wifi_connect_req_params params = { 0 };

	if (wifi_iface == NULL || wifi_ssid_length == 0U) {
		return wifi_iface == NULL ? -ENODEV : -EINVAL;
	}

	params.ssid = wifi_ssid;
	params.ssid_length = wifi_ssid_length;
	params.psk = wifi_password;
	params.psk_length = wifi_password_length;
	params.channel = WIFI_CHANNEL_ANY;
	params.band = WIFI_FREQ_BAND_2_4_GHZ;
	params.security = wifi_password_length == 0U ?
		WIFI_SECURITY_TYPE_NONE : WIFI_SECURITY_TYPE_WPA_AUTO_PERSONAL;
	params.mfp = wifi_password_length == 0U ? WIFI_MFP_DISABLE :
		WIFI_MFP_OPTIONAL;

	return net_mgmt(NET_REQUEST_WIFI_CONNECT, wifi_iface, &params,
			       sizeof(params));
}

static int wifi_disconnect(void)
{
	if (wifi_iface == NULL) {
		return -ENODEV;
	}

	return net_mgmt(NET_REQUEST_WIFI_DISCONNECT, wifi_iface, NULL, 0U);
}

static int wifi_format_scan_item(char *response, size_t response_size)
{
	struct qcc74xsync_wifi_scan_item item;
	char ssid[WIFI_SSID_MAX_LEN * 6U + 1U];
	int length;

	k_mutex_lock(&wifi_cache_lock, K_FOREVER);
	if (wifi_scan_write_index == 0U) {
		k_mutex_unlock(&wifi_cache_lock);
		return -EAGAIN;
	}
	if (wifi_scan_read_index == wifi_scan_write_index) {
		wifi_scan_read_index = 0U;
		wifi_scan_write_index = 0U;
		k_mutex_unlock(&wifi_cache_lock);
		return 0;
	}

	item = wifi_scan_items[wifi_scan_read_index++];
	SCB_TRACE("WIFI_ITEM|idx=%u|count=%u|chan=%u|auth=%u|rssi=%d|ssid_len=%u",
		  wifi_scan_read_index, wifi_scan_write_index, item.channel,
		  item.auth, item.rssi, item.ssid_length);
	k_mutex_unlock(&wifi_cache_lock);

	if (json_escape(ssid, sizeof(ssid), item.ssid, item.ssid_length) != 0) {
		return -ENOSPC;
	}

	length = snprintk(response, response_size,
			  "{\"chan\":%u,\"bssid\":\"%02X:%02X:%02X:%02X:%02X:%02X\","
			  "\"rssi\":%d,\"ssid\":\"%s\",\"auth\":%u}",
			  item.channel, item.bssid[0], item.bssid[1], item.bssid[2],
			  item.bssid[3], item.bssid[4], item.bssid[5], item.rssi,
			  ssid, item.auth);
	if (length < 0 || (size_t)length >= response_size) {
		return -ENOSPC;
	}

	SCB_TRACE("WIFI_JSON|len=%d", length);
	return length;
}

static int wifi_format_state(char *response, size_t response_size)
{
	struct wifi_iface_status status = { 0 };
	struct net_in_addr netmask;
	struct net_in_addr gateway;
	struct net_in_addr *address;
	char ssid[WIFI_SSID_MAX_LEN * 6U + 1U];
	char ip[NET_IPV4_ADDR_LEN] = "0.0.0.0";
	char mask[NET_IPV4_ADDR_LEN] = "0.0.0.0";
	char gw[NET_IPV4_ADDR_LEN] = "0.0.0.0";
	int state = 3;
	int length;

	if (wifi_iface == NULL || net_mgmt(NET_REQUEST_WIFI_IFACE_STATUS,
					     wifi_iface, &status, sizeof(status)) != 0) {
		return wifi_iface == NULL ? -ENODEV : -EIO;
	}

	address = net_if_ipv4_get_global_addr(wifi_iface, NET_ADDR_PREFERRED);
	if (address != NULL) {
		netmask = net_if_ipv4_get_netmask_by_addr(wifi_iface, address);
		gateway = net_if_ipv4_get_gw(wifi_iface);
		(void)net_addr_ntop(NET_AF_INET, address, ip, sizeof(ip));
		(void)net_addr_ntop(NET_AF_INET, &netmask, mask, sizeof(mask));
		(void)net_addr_ntop(NET_AF_INET, &gateway, gw, sizeof(gw));
		state = 4;
	}

	if (json_escape(ssid, sizeof(ssid), (const uint8_t *)status.ssid,
				MIN((size_t)status.ssid_len,
				    (size_t)WIFI_SSID_MAX_LEN)) != 0) {
		return -ENOSPC;
	}

	length = snprintk(response, response_size,
			  "{\"state\":%d,\"ip\":\"%s\",\"gw\":\"%s\",\"mask\":\"%s\","
			  "\"ssid\":\"%s\",\"bssid\":\"%02X:%02X:%02X:%02X:%02X:%02X\"}",
			  state, ip, gw, mask, ssid, (uint8_t)status.bssid[0],
			  (uint8_t)status.bssid[1], (uint8_t)status.bssid[2],
			  (uint8_t)status.bssid[3], (uint8_t)status.bssid[4],
			  (uint8_t)status.bssid[5]);
	if (length < 0 || (size_t)length >= response_size) {
		return -ENOSPC;
	}

	return length;
}

static void wifi_mgmt_event_handler(struct net_mgmt_event_callback *cb,
					    uint64_t mgmt_event,
					    struct net_if *iface)
{
	const struct wifi_status *status;

	if (iface != wifi_iface) {
		return;
	}

	switch (mgmt_event) {
	case NET_EVENT_WIFI_SCAN_RESULT: {
		const struct wifi_scan_result *result = cb->info;
		struct qcc74xsync_wifi_scan_item *item;
		size_t ssid_length;

		if (result == NULL) {
			return;
		}
		k_mutex_lock(&wifi_cache_lock, K_FOREVER);
		if (!wifi_scan_active ||
		    wifi_scan_write_index >= SMARTCONFIG_WIFI_SCAN_MAX) {
			k_mutex_unlock(&wifi_cache_lock);
			return;
		}

		item = &wifi_scan_items[wifi_scan_write_index++];
		ssid_length = MIN((size_t)result->ssid_length,
				  (size_t)WIFI_SSID_MAX_LEN);
		memcpy(item->ssid, result->ssid, ssid_length);
		item->ssid[ssid_length] = '\0';
		item->ssid_length = ssid_length;
		memcpy(item->bssid, result->mac, WIFI_MAC_ADDR_LEN);
		item->channel = result->channel;
		item->auth = wifi_auth_from_security(result->security);
		item->rssi = result->rssi;
		SCB_TRACE("WIFI_ITEM_RX|idx=%u|chan=%u|auth=%u|rssi=%d|ssid_len=%u",
			  wifi_scan_write_index, item->channel, item->auth,
			  item->rssi, item->ssid_length);
		k_mutex_unlock(&wifi_cache_lock);
		break;
	}
	case NET_EVENT_WIFI_SCAN_DONE:
		k_mutex_lock(&wifi_cache_lock, K_FOREVER);
		wifi_scan_active = false;
		k_mutex_unlock(&wifi_cache_lock);
		status = cb->info;
		SCB_TRACE("WIFI_SCAN_DONE|status=%d|count=%u",
			  status != NULL ? status->status : -EIO, wifi_scan_write_index);
		break;
	case NET_EVENT_WIFI_CONNECT_RESULT:
	case NET_EVENT_WIFI_DISCONNECT_RESULT:
		status = cb->info;
		printk("smartconfig_ble: Wi-Fi event 0x%llx result %d\n",
		       mgmt_event, status != NULL ? status->status : -EIO);
		break;
	default:
		break;
	}
}

int qcc74xsync_ble_app_init(struct qcc74xsync_transfer *new_transfer)
{
	transfer = new_transfer;
	wifi_iface = net_if_get_wifi_sta();
	if (wifi_iface == NULL) {
		printk("smartconfig_ble: Wi-Fi STA interface not available\n");
		return -ENODEV;
	}

	net_mgmt_init_event_callback(&wifi_mgmt_callback, wifi_mgmt_event_handler,
				     SMARTCONFIG_WIFI_EVENT_MASK);
	net_mgmt_add_event_callback(&wifi_mgmt_callback);
	return 0;
}

int qcc74xsync_ble_app_event(void *ctx, const struct qcc74xsync_event *event)
{
	char response[QCC74XSYNC_PROTOCOL_BUF_SIZE];
	int length;

	ARG_UNUSED(ctx);

	if (event->type == QCC74XSYNC_EVENT_DATA) {
		switch (event->id) {
		case QCC74XSYNC_DATA_ACK:
			return 0;
		case QCC74XSYNC_DATA_STA_WIFI_SSID:
			return wifi_set_credential(wifi_ssid, &wifi_ssid_length,
						   WIFI_SSID_MAX_LEN, event->data,
						   event->length);
		case QCC74XSYNC_DATA_STA_WIFI_PASSWORD:
			return wifi_set_credential(wifi_password, &wifi_password_length,
						   SMARTCONFIG_WIFI_PSK_MAX, event->data,
						   event->length);
		case QCC74XSYNC_DATA_STA_WIFI_BSSID:
			return event->length <= WIFI_MAC_ADDR_LEN ? 0 : -EINVAL;
		default:
			return -EINVAL;
		}
	}

	switch (event->id) {
	case QCC74XSYNC_CMD_ACK:
		return 0;
	case QCC74XSYNC_CMD_GET_VERSION:
		return qcc74xsync_transfer_set_response(transfer,
							QCC74XSYNC_PROTOCOL_VERSION,
							sizeof(QCC74XSYNC_PROTOCOL_VERSION));
	case QCC74XSYNC_CMD_CONNECT_WIFI:
		return wifi_connect();
	case QCC74XSYNC_CMD_DISCONNECT_WIFI:
		return wifi_disconnect();
	case QCC74XSYNC_CMD_GET_WIFI_STATUS:
	case QCC74XSYNC_CMD_WIFI_STATE_GET:
		length = wifi_format_state(response, sizeof(response));
		return length < 0 ? length :
			qcc74xsync_transfer_set_response(transfer, response, length);
	case QCC74XSYNC_CMD_WIFI_SCAN:
		return wifi_start_scan();
	case QCC74XSYNC_CMD_WIFI_DATA_GET:
		length = wifi_format_scan_item(response, sizeof(response));
		if (length == -EAGAIN) {
			return QCC74XSYNC_PROTOCOL_RESULT_NOT_READY;
		}
		return length < 0 ? length :
			qcc74xsync_transfer_set_response(transfer, response, length);
	default:
		return -EINVAL;
	}
}
```

## src/qcc74xsync_ble_app.h
```c
/*
 * Copyright (c) Qualcomm Technologies, Inc. and/or its subsidiaries
 * SPDX-License-Identifier: BSD-3-Clause
 */

#ifndef QCC74XSYNC_BLE_APP_H_
#define QCC74XSYNC_BLE_APP_H_

#include "transfer.h"

int qcc74xsync_ble_app_init(struct qcc74xsync_transfer *transfer);
int qcc74xsync_ble_app_event(void *ctx,
				     const struct qcc74xsync_event *event);

#endif /* QCC74XSYNC_BLE_APP_H_ */
```

## src/transfer.c
```c
/*
 * Copyright (c) Qualcomm Technologies, Inc. and/or its subsidiaries
 * SPDX-License-Identifier: BSD-3-Clause
 */

#include "transfer.h"

#include <errno.h>
#include <stdbool.h>
#include <string.h>

#include <zephyr/sys/printk.h>
#include <zephyr/sys/util.h>

#include "encrypt_layer.h"
#include "payload.h"

#define CTRL_RETRY_BIT 0U
#define CTRL_FRAG_BIT 1U
#define CTRL_ACK_BIT 3U
#define CTRL_TYPE_BIT 4U
#define FRAG_END_BIT 15U
#define PROTOCOL_ACK 1U
#define PROTOCOL_NO_ACK 0U

#define SCB_TRACE(fmt, ...) printk("scbtr|" fmt "\n", ##__VA_ARGS__)

static uint16_t read_le16(const uint8_t *data)
{
	return (uint16_t)data[0] | ((uint16_t)data[1] << 8);
}

static void write_le16(uint8_t *data, uint16_t value)
{
	data[0] = (uint8_t)value;
	data[1] = (uint8_t)(value >> 8);
}

static bool bit_get(uint8_t value, uint8_t bit)
{
	return (value & BIT(bit)) != 0U;
}

static void clear_reassembly(struct qcc74xsync_transfer *transfer)
{
	if (transfer->payload != NULL) {
		k_free(transfer->payload);
		transfer->payload = NULL;
	}
	transfer->payload_length = 0U;
	transfer->payload_received = 0U;
}

static int send_packet(struct qcc74xsync_transfer *transfer, uint8_t seq,
			       uint8_t ack, uint8_t event_id, const uint8_t *data,
			       uint16_t length)
{
	uint8_t packet[QCC74XSYNC_PROTOCOL_BUF_SIZE];
	uint16_t total = 0U;
	uint16_t fragment = 0U;
	bool first = true;

	if (transfer->send == NULL || transfer->mtu < 20U ||
	    transfer->mtu > sizeof(packet)) {
		return -EINVAL;
	}

	while (total < length || first) {
		uint8_t ctrl = 0U;
		uint8_t *cursor = &packet[4];
		uint8_t frame_length = 4U;
		uint16_t remaining = transfer->mtu - 4U;
		int payload_size;
		uint8_t *length_field;
		static const uint8_t empty_data;

		if (first) {
			if (remaining < 3U) {
				return -EINVAL;
			}
			write_le16(cursor, length);
			cursor += 2U;
			frame_length += 2U;
			remaining -= 2U;
		}

		length_field = cursor++;
		*length_field = 0U;
		frame_length++;
		remaining--;

		payload_size = qcc74xsync_encrypt_write(
			QCC74XSYNC_PACKET_DATA, event_id, cursor, &frame_length,
			data != NULL ? &data[total] : &empty_data, length - total,
			remaining, first);
		if (payload_size < 0) {
			return payload_size;
		}

		total += (uint16_t)payload_size;
		if (total >= length) {
			packet[2] = (uint8_t)fragment;
			packet[3] = (uint8_t)(fragment >> 8) | 0x80U;
		} else {
			packet[2] = (uint8_t)fragment;
			packet[3] = (uint8_t)(fragment >> 8);
			ctrl |= BIT(CTRL_FRAG_BIT);
		}

		ctrl |= ack ? BIT(CTRL_ACK_BIT) : 0U;
		ctrl |= QCC74XSYNC_PACKET_DATA << CTRL_TYPE_BIT;
		packet[0] = ctrl;
		packet[1] = seq++;
		*length_field = frame_length - (first ? 7U : 5U);
		SCB_TRACE("TX|len=%u|ctrl=%02x|seq=%u|frag=%u|src=%u|payload=%u|total=%u",
			  frame_length, ctrl, packet[1],
			  (uint16_t)packet[2] | ((uint16_t)packet[3] << 8),
			  length, (unsigned int)payload_size, total);

		if (transfer->send(transfer->ctx, packet, frame_length) < 0) {
			return -EIO;
		}

		if (k_sem_take(&transfer->ack_sem,
				       K_MSEC(QCC74XSYNC_PROTOCOL_TIMEOUT_MS)) != 0) {
			SCB_TRACE("TX_ACK|result=timeout|len=%u|seq=%u|frag=%u",
				  frame_length, packet[1],
				  (uint16_t)packet[2] | ((uint16_t)packet[3] << 8));
			return -ETIMEDOUT;
		}

		fragment++;
		first = false;
	}

	return 0;
}

static int send_ack(struct qcc74xsync_transfer *transfer, uint8_t seq,
			    int result)
{
	return send_packet(transfer, seq, PROTOCOL_ACK, (uint8_t)result,
				   transfer->ack_buffer, transfer->ack_length);
}

static int receive_packet(struct qcc74xsync_transfer *transfer,
				  const uint8_t *data, size_t length)
{
	uint8_t ctrl;
	uint8_t seq;
	uint16_t fragment;
	uint16_t fragment_index;
	bool first_fragment;
	const uint8_t *payload;
	size_t payload_length;
	uint8_t event_id = 0U;
	uint8_t event_length = 0U;
	int result;

	if (length < 4U) {
		return -EINVAL;
	}

	ctrl = data[0];
	seq = data[1];
	fragment = read_le16(&data[2]);
	fragment_index = fragment & ~BIT(FRAG_END_BIT);
	first_fragment = fragment_index == 0U;
	payload = &data[4];
	payload_length = length - 4U;
	SCB_TRACE("RX|len=%u|ctrl=%02x|seq=%u|frag=%u|type=%u",
		  (unsigned int)length, ctrl, seq, fragment,
		  (ctrl >> CTRL_TYPE_BIT) & 0x03U);

	if (bit_get(ctrl, CTRL_RETRY_BIT)) {
		if (seq != transfer->old_seq) {
			transfer->old_seq = seq;
			transfer->sequence_started_ms = k_uptime_get();
		}
		if ((k_uptime_get() - transfer->sequence_started_ms) >
		    QCC74XSYNC_PROTOCOL_TIMEOUT_MS) {
			clear_reassembly(transfer);
			return -ETIMEDOUT;
		}
	}

	if (first_fragment) {
		uint8_t source_length;
		uint16_t new_payload_length;
		bool compact_cmd;

		if (payload_length < 3U) {
			return -EINVAL;
		}
		new_payload_length = read_le16(payload);
		source_length = payload[2];
		payload += 3U;
		payload_length -= 3U;
		compact_cmd = ((ctrl >> CTRL_TYPE_BIT) & 0x03U) ==
			QCC74XSYNC_PACKET_CMD && length == 20U &&
			new_payload_length == 4U && source_length == payload_length + 1U &&
			bit_get((uint8_t)(fragment >> 8), 7U);
		if (payload_length != source_length && !compact_cmd) {
			clear_reassembly(transfer);
			return -EINVAL;
		}

		clear_reassembly(transfer);
		transfer->payload_length = new_payload_length;
		if (transfer->payload_length > 0U) {
			transfer->payload = k_malloc(transfer->payload_length);
			if (transfer->payload == NULL) {
				return -ENOMEM;
			}
		}
	} else {
		uint8_t source_length;

		if (payload_length < 1U) {
			return -EINVAL;
		}
		source_length = payload[0];
		payload++;
		payload_length--;
		if (payload_length != source_length) {
			clear_reassembly(transfer);
			return -EINVAL;
		}
	}

	if (transfer->payload_received > transfer->payload_length) {
		return -EINVAL;
	}

	{
		uint8_t empty_payload;
		uint8_t *destination = transfer->payload != NULL ?
			&transfer->payload[transfer->payload_received] : &empty_payload;

		result = qcc74xsync_encrypt_read(
			(ctrl >> CTRL_TYPE_BIT) & 0x03U, &event_id, destination,
			&event_length, payload, payload_length, first_fragment,
			transfer->payload_length - transfer->payload_received);
	}
	if (result < 0) {
		clear_reassembly(transfer);
		return result;
	}

	transfer->payload_received += event_length;
	if (!bit_get(ctrl, CTRL_FRAG_BIT) ||
	    bit_get((uint8_t)(fragment >> 8), 7U)) {
		struct qcc74xsync_event event = {
			.type = ((ctrl >> CTRL_TYPE_BIT) & 0x03U) ==
				QCC74XSYNC_PACKET_CMD ? QCC74XSYNC_EVENT_CMD :
				QCC74XSYNC_EVENT_DATA,
			.id = event_id,
			.data = transfer->payload,
			.length = transfer->payload_received,
		};

		if (transfer->payload_received != transfer->payload_length) {
			clear_reassembly(transfer);
			return -EINVAL;
		}

		transfer->response_length = 0U;
		transfer->ack_buffer = NULL;
		transfer->ack_length = 0U;
		result = transfer->event(transfer->ctx, &event);
		if (result == 0 && transfer->response_length > 0U) {
			transfer->ack_buffer = transfer->response;
			transfer->ack_length = transfer->response_length;
		}
		if (!bit_get(ctrl, CTRL_ACK_BIT)) {
			int ack_result = send_ack(transfer, seq, result);

			transfer->response_length = 0U;
			clear_reassembly(transfer);
			return ack_result < 0 ? ack_result : result;
		}

		transfer->response_length = 0U;
		clear_reassembly(transfer);
		return result;
	}

	return 0;
}

int qcc74xsync_transfer_init(struct qcc74xsync_transfer *transfer,
				     qcc74xsync_send_fn send,
				     qcc74xsync_event_fn event, void *ctx)
{
	if (transfer == NULL || send == NULL || event == NULL) {
		return -EINVAL;
	}

	memset(transfer, 0, sizeof(*transfer));
	transfer->send = send;
	transfer->event = event;
	transfer->ctx = ctx;
	k_sem_init(&transfer->ack_sem, 0, 1);
	return 0;
}

int qcc74xsync_transfer_set_response(struct qcc74xsync_transfer *transfer,
					     const void *data, size_t length)
{
	if (transfer == NULL || data == NULL ||
	    length > sizeof(transfer->response)) {
		return -EINVAL;
	}

	memcpy(transfer->response, data, length);
	transfer->response_length = length;
	return 0;
}

int qcc74xsync_transfer_receive(struct qcc74xsync_transfer *transfer,
					const uint8_t *data, size_t length,
					uint16_t mtu)
{
	if (transfer == NULL || data == NULL || length < 2U || mtu < 20U) {
		return -EINVAL;
	}

	transfer->mtu = mtu;
	return receive_packet(transfer, data, length);
}

int qcc74xsync_transfer_send(struct qcc74xsync_transfer *transfer,
					 const void *data, uint16_t length)
{
	if (transfer == NULL || (length > 0U && data == NULL)) {
		return -EINVAL;
	}

	return send_packet(transfer, 0U, PROTOCOL_NO_ACK, 0U, data, length);
}

int qcc74xsync_transfer_ack(struct qcc74xsync_transfer *transfer)
{
	if (transfer == NULL) {
		return -EINVAL;
	}

	k_sem_give(&transfer->ack_sem);
	return 0;
}

void qcc74xsync_transfer_reset(struct qcc74xsync_transfer *transfer)
{
	if (transfer == NULL) {
		return;
	}

	clear_reassembly(transfer);
	transfer->response_length = 0U;
	transfer->ack_buffer = NULL;
	transfer->ack_length = 0U;
	transfer->sequence_started_ms = 0;
}
```

## src/transfer.h
```c
/*
 * Copyright (c) Qualcomm Technologies, Inc. and/or its subsidiaries
 * SPDX-License-Identifier: BSD-3-Clause
 */

#ifndef QCC74XSYNC_TRANSFER_H_
#define QCC74XSYNC_TRANSFER_H_

#include <stddef.h>
#include <stdint.h>

#include <zephyr/kernel.h>

#include "pro_config.h"

#define QCC74XSYNC_PROTOCOL_VERSION "v1.1.0"

#define QCC74XSYNC_PROTOCOL_RESULT_OK 0U
#define QCC74XSYNC_PROTOCOL_RESULT_NOT_READY 1U
#define QCC74XSYNC_PROTOCOL_RESULT_ERROR 2U
#define QCC74XSYNC_PROTOCOL_RESULT_NO_MEM 3U
#define QCC74XSYNC_PROTOCOL_RESULT_TIMEOUT 4U

enum qcc74xsync_event_type {
	QCC74XSYNC_EVENT_CMD = 0,
	QCC74XSYNC_EVENT_DATA = 1,
};

enum qcc74xsync_cmd_id {
	QCC74XSYNC_CMD_ACK = 0x00,
	QCC74XSYNC_CMD_SET_SEC_MODE,
	QCC74XSYNC_CMD_SET_OP_MODE,
	QCC74XSYNC_CMD_CONNECT_WIFI,
	QCC74XSYNC_CMD_DISCONNECT_WIFI,
	QCC74XSYNC_CMD_GET_WIFI_STATUS,
	QCC74XSYNC_CMD_DEAUTHENTICATE,
	QCC74XSYNC_CMD_GET_VERSION,
	QCC74XSYNC_CMD_CLOSE_CONNECTION,
	QCC74XSYNC_CMD_WIFI_SCAN,
	QCC74XSYNC_CMD_DATA_GET_PREPARE,
	QCC74XSYNC_CMD_WIFI_DATA_GET,
	QCC74XSYNC_CMD_PROV_STOP,
	QCC74XSYNC_CMD_WIFI_STATE_GET,
};

enum qcc74xsync_data_id {
	QCC74XSYNC_DATA_ACK = 0x00,
	QCC74XSYNC_DATA_STA_WIFI_BSSID,
	QCC74XSYNC_DATA_STA_WIFI_SSID,
	QCC74XSYNC_DATA_STA_WIFI_PASSWORD,
	QCC74XSYNC_DATA_SOFTAP_WIFI_SSID,
	QCC74XSYNC_DATA_SOFTAP_WIFI_PASSWORD,
	QCC74XSYNC_DATA_SOFTAP_MAX_CONNECTION_COUNT,
	QCC74XSYNC_DATA_SOFTAP_AUTH_MODE,
	QCC74XSYNC_DATA_SOFTAP_CHANNEL,
	QCC74XSYNC_DATA_USERNAME,
	QCC74XSYNC_DATA_CA_CERTIFICATION,
	QCC74XSYNC_DATA_CLIENT_CERTIFICATION,
	QCC74XSYNC_DATA_SERVER_CERTIFICATION,
	QCC74XSYNC_DATA_CLIENT_PRIVATE_KEY,
	QCC74XSYNC_DATA_SERVER_PRIVATE_KEY,
	QCC74XSYNC_DATA_WIFI_CONNECTION_STATE,
	QCC74XSYNC_DATA_VERSION,
	QCC74XSYNC_DATA_WIFI_LIST,
	QCC74XSYNC_DATA_ERROR,
	QCC74XSYNC_DATA_CUSTOM_DATA,
};

struct qcc74xsync_event {
	enum qcc74xsync_event_type type;
	uint8_t id;
	const uint8_t *data;
	size_t length;
};

typedef int (*qcc74xsync_send_fn)(void *ctx, const uint8_t *data,
					 size_t length);
typedef int (*qcc74xsync_event_fn)(void *ctx,
					 const struct qcc74xsync_event *event);

struct qcc74xsync_transfer {
	qcc74xsync_send_fn send;
	qcc74xsync_event_fn event;
	void *ctx;

	uint8_t old_seq;
	uint8_t *payload;
	uint16_t payload_length;
	uint16_t payload_received;
	uint16_t mtu;

	uint8_t response[QCC74XSYNC_PROTOCOL_BUF_SIZE];
	uint16_t response_length;
	uint8_t *ack_buffer;
	uint16_t ack_length;

	int64_t sequence_started_ms;
	struct k_sem ack_sem;
};

int qcc74xsync_transfer_init(struct qcc74xsync_transfer *transfer,
				     qcc74xsync_send_fn send,
				     qcc74xsync_event_fn event, void *ctx);
int qcc74xsync_transfer_receive(struct qcc74xsync_transfer *transfer,
					const uint8_t *data, size_t length,
					uint16_t mtu);
int qcc74xsync_transfer_send(struct qcc74xsync_transfer *transfer,
					 const void *data, uint16_t length);
int qcc74xsync_transfer_ack(struct qcc74xsync_transfer *transfer);
int qcc74xsync_transfer_set_response(struct qcc74xsync_transfer *transfer,
					     const void *data, size_t length);
void qcc74xsync_transfer_reset(struct qcc74xsync_transfer *transfer);

#endif /* QCC74XSYNC_TRANSFER_H_ */
```
