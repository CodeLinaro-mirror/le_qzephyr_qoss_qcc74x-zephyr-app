## qcc74x_testing/tests/drivers/counter/counter_seconds/testcase.yaml
```yaml
tests:
  qcc7xx.drivers.counter.seconds:
    tags:
      - drivers
      - counter
    depends_on: counter
    min_ram: 16
    platform_allow:
      - qcc748m_evk
    timeout: 600
```

## qcc74x_testing/tests/drivers/dac/dac_dma_api/testcase.yaml
```yaml
# Copyright (c) 2026 Qualcomm Technologies, Inc. and/or its subsidiaries
# SPDX-License-Identifier: BSD-3-Clause

common:
  tags:
    - dac
    - drivers
    - userspace
tests:
  qcc7xx.drivers.dac.dma_api:
    build_only: true
    depends_on: 
    - dac
    - dma
    platform_allow:
      - qcc743m_evk
      - qcc744m_evk
      - qcc748m_evk
```

## qcc74x_testing/tests/drivers/dac/dac_loopback/testcase.yaml
```yaml
common:
  tags:
    - dac
    - drivers
  depends_on:
    - dac
    - adc
  harness: ztest
  harness_config:
    fixture: dac_adc_loopback
tests:
  drivers.dac.loopback:
    filter: dt_node_has_prop("/zephyr,user", "io-channels")
```

## qcc74x_testing/tests/drivers/efuse/efuse_api/testcase.yaml
```yaml
# Copyright (c) 2026 Qualcomm Technologies, Inc. and/or its subsidiaries
# SPDX-License-Identifier: BSD-3-Clause

tests:
  drivers.efuse:
    tags:
      - drivers
      - syscon
    harness: ztest
    platform_allow:
      - qcc744m_evk
      - qcc748m_evk
      - qcc743m_evk
      - qcc75xm_evk
```

## qcc74x_testing/tests/drivers/i2c/eeprom/testcase.yaml
```yaml
# Copyright (c) 2026 Qualcomm Technologies, Inc. and/or its subsidiaries
# SPDX-License-Identifier: Apache-2.0

common:
  depends_on: i2c
  tags:
    - drivers
    - i2c
    - eeprom
  harness: ztest
  harness_config:
    fixture: i2c_eeprom
  extra_dtc_overlay_files:
    - "boards/${BOARD}.overlay"
    # - "eeprom_24lc16b.overlay" # Uncomment if connected EEPROM is 24LC16B-I/P
  platform_allow:
    - qcc743m_evk
    - qcc744m_evk
    - qcc748m_evk

tests:
  qcc7xx.drivers.i2c.eeprom: {}
  qcc7xx.drivers.i2c.eeprom.dma:
    extra_dtc_overlay_files:
      - "i2c_dma.overlay"
    extra_configs:
      - CONFIG_I2C_QCC74X_DMA=y
  qcc7xx.drivers.i2c.eeprom.async:
    extra_configs:
      - CONFIG_EEPROM_USE_I2C_CALLBACK=y
  qcc7xx.drivers.i2c.eeprom.async_dma:
    extra_dtc_overlay_files:
      - "i2c_dma.overlay"
    extra_configs:
      - CONFIG_I2C_QCC74X_DMA=y
      - CONFIG_EEPROM_USE_I2C_CALLBACK=y
```

## qcc74x_testing/tests/drivers/i2s/loopback/testcase.yaml
```yaml
# Copyright (c) 2026 Qualcomm Technologies, Inc. and/or its subsidiaries
# SPDX-License-Identifier: BSD-3-Clause

tests:
  qcc7xx.drivers.i2s.loopback:
    depends_on:
      - i2s
      - gpio
      - dma
    tags:
      - drivers
      - i2s
    harness: ztest
    harness_config:
      fixture: gpio_loopback
    platform_allow:
      - qcc744m_evk
      - qcc748m_evk
```

## qcc74x_testing/tests/drivers/pwm/pwm_gpio_loopback/Kconfig
```kconfig
# Copyright (c) 2024 Espressif Systems (Shanghai) Co., Ltd.
# SPDX-License-Identifier: Apache-2.0

mainmenu "PWM GPIO loopback test"

source "Kconfig.zephyr"

config SAMPLING_TIME
	int "Sampling wait time (ms)"
	default 50

config SKIP_EDGE_NUM
	int "Number of edges to skip before sampling PWM"
	default 2

config ALLOWED_DEVIATION
	int "Allowed deviation (%) for PWM timing checks"
	default 5
	range 0 100
```

## qcc74x_testing/tests/drivers/pwm/pwm_gpio_loopback/testcase.yaml
```yaml
common:
  depends_on: pwm
  tags:
    - drivers
    - pwm
  harness: ztest
  harness_config:
    fixture: gpio_loopback
tests:
  drivers.pwm.gpio_loopback.esp:
    platform_allow:
      - esp32_devkitc_wrover/esp32/procpu
      - esp8684_devkitm
      - esp32c3_devkitm
      - esp32c6_devkitc
      - esp32s2_saola
      - esp32s3_devkitm/esp32s3/procpu

  drivers.pwm.gpio_loopback.nrf:
    platform_allow:
      - nrf54h20dk/nrf54h20/cpuapp
      - nrf54l15dk/nrf54l15/cpuapp

  drivers.pwm.gpio_loopback.qcc7xx_xclk:
    platform_allow:
      - qcc743m_evk
      - qcc744m_evk
      - qcc748m_evk
      - qcc75xm_evk
  drivers.pwm.gpio_loopback.qcc7xx_bclk:
    platform_allow:
      - qcc743m_evk
      - qcc744m_evk
      - qcc748m_evk
      - qcc75xm_evk
    extra_args:
      - EXTRA_DTC_OVERLAY_FILE="boards/qcc7xxm_evk_bclk.overlay"
  drivers.pwm.gpio_loopback.qcc7xx_clk_32k:
    platform_allow:
      - qcc743m_evk
      - qcc744m_evk
      - qcc748m_evk
      - qcc75xm_evk
    extra_args:
      - EXTRA_DTC_OVERLAY_FILE="boards/qcc7xxm_evk_clk_32k.overlay"
```

## qcc74x_testing/tests/drivers/reset/basic_api/testcase.yaml
```yaml
common:
  tags:
    - drivers
    - reset
tests:
  drivers.reset.basic_api:
    platform_allow:
      - qcc748m_evk
```

## qcc74x_testing/tests/drivers/rtc/rtc_lifecycle/testcase.yaml
```yaml
# Copyright (c) Qualcomm Technologies, Inc. and/or its subsidiaries
# SPDX-License-Identifier: BSD-3-Clause

tests:
  qcc7xx.drivers.rtc.lifecycle:
    tags:
      - drivers
      - rtc
      - l2
    depends_on: rtc
    filter: dt_alias_exists("rtc")
    platform_allow:
      - qcc748m_evk
    timeout: 30
```

## qcc74x_testing/tests/drivers/spi/pytest_shell/testcase.yaml
```yaml
# Copyright (c) Qualcomm Technologies, Inc. and/or its subsidiaries.
# SPDX-License-Identifier: BSD-3-Clause

# Focused Windows L4 SPI shell run. The default matrix intentionally keeps
# smoke coverage, one explicit interrupt/STO check, and two useful throughput points:
#   - MOSI at 40 MHz
#   - MISO at 26 MHz

common:
  tags: drivers spi shell
  depends_on: spi
  platform_allow:
    - qcc743m_evk
    - qcc744m_evk
    - qcc748m_evk
  min_ram: 32
  harness: pytest

tests:
  qcc7xx.drivers.spi.shell.single_board.polling:
    harness_config:
      pytest_root: ["scripts/test_spi_shell.py"]
      pytest_args:
        - "-m"
        - "single_board"
        - "-k"
        - "test_1_1_command_smoke or test_1_8_transceive_hex_data"
      pytest_dut_scope: session
    extra_conf_files: [overlay-spi-polling.conf]
    extra_args: DTC_OVERLAY_FILE=boards/qcc748m_evk_single.overlay
    timeout: 300

  qcc7xx.drivers.spi.shell.dual_board.polling:
    harness_config:
      pytest_root: ["scripts/test_spi_shell.py"]
      pytest_args:
        - "-m"
        - "dual_board and not interrupt_only and not dma_only"
        - "-k"
        - "test_2_1_command_smoke or test_2_2_full_duplex_4B"
      pytest_dut_scope: session
    extra_conf_files: [overlay-spi-polling.conf]
    timeout: 600

  qcc7xx.drivers.spi.shell.dual_board.interrupt_sto:
    harness_config:
      pytest_root: ["scripts/test_spi_shell.py"]
      pytest_args:
        - "-m"
        - "dual_board and interrupt_only"
        - "-k"
        - "test_2_8_slave_timeout"
      pytest_dut_scope: session
    extra_conf_files: [overlay-spi-interrupt.conf]
    timeout: 600

  qcc7xx.drivers.spi.shell.dual_board.dma_throughput_mosi_40mhz:
    harness_config:
      pytest_root: ["scripts/test_spi_shell.py"]
      pytest_args:
        - "-m"
        - "dual_board and dma_only"
        - "-k"
        - "test_2_11_board_side_throughput_64k"
      pytest_dut_scope: session
    extra_conf_files: [overlay-spi-dma-throughput.conf]
    extra_args:
      - DTC_OVERLAY_FILE="boards/qcc748m_evk.overlay;boards/spi-clk-160m.overlay"
    timeout: 600

  qcc7xx.drivers.spi.shell.dual_board.dma_throughput_miso_26mhz:
    harness_config:
      pytest_root: ["scripts/test_spi_shell.py"]
      pytest_args:
        - "-m"
        - "dual_board and dma_only"
        - "-k"
        - "test_2_12_board_side_throughput_miso_26mhz"
      pytest_dut_scope: session
    extra_conf_files: [overlay-spi-dma-throughput.conf]
    extra_args:
      - DTC_OVERLAY_FILE="boards/qcc748m_evk.overlay;boards/spi-clk-160m.overlay"
    timeout: 600
```

## qcc74x_testing/tests/drivers/spi/spi_loopback/testcase.yaml
```yaml
common:
  depends_on: spi
  tags:
    - drivers
    - spi
  filter: dt_compat_enabled("test-spi-loopback-slow") and
          dt_compat_enabled("test-spi-loopback-fast")
  harness: ztest
  harness_config:
    fixture: spi_loopback
tests:
  qcc7xx.drivers.spi.loopback.opal_spi_polling:
    extra_args: EXTRA_CONF_FILE="overlay-qcc74x-spi-polling.conf"
    platform_allow:
      - qcc743m_evk
      - qcc744m_evk
      - qcc748m_evk
  qcc7xx.drivers.spi.loopback.opal_spi_dma:
    extra_args: EXTRA_CONF_FILE="overlay-qcc74x-spi-dma.conf"
    platform_allow:
      - qcc743m_evk
      - qcc744m_evk
      - qcc748m_evk
  qcc7xx.drivers.spi.loopback.opal_spi_interrupt:
    extra_args: EXTRA_CONF_FILE="overlay-qcc74x-spi-interrupt.conf"
    platform_allow:
      - qcc743m_evk
      - qcc744m_evk
      - qcc748m_evk
```

## qcc74x_testing/tests/drivers/spi/spi_stress/testcase.yaml
```yaml
# Copyright (c) Qualcomm Technologies, Inc. and/or its subsidiaries.
# SPDX-License-Identifier: BSD-3-Clause

common:
  # Run from this directory with: west twister -T . --device-testing
  # The hardware map supplies the board port and spi_loopback fixture.
  depends_on: spi
  tags:
    - drivers
    - spi
  filter: dt_compat_enabled("test-spi-loopback-slow") and
          dt_compat_enabled("test-spi-loopback-fast")
  harness: ztest
  harness_config:
    fixture: spi_loopback
  timeout: 1800

tests:
  qcc7xx.drivers.spi.stress.qcc74x_spi_polling:
    extra_args: EXTRA_CONF_FILE="overlay-qcc74x-spi-polling.conf"
    platform_allow:
      - qcc748m_evk
  qcc7xx.drivers.spi.stress.qcc74x_spi_dma:
    extra_args: EXTRA_CONF_FILE="overlay-qcc74x-spi-dma.conf"
    platform_allow:
      - qcc748m_evk
  qcc7xx.drivers.spi.stress.qcc74x_spi_interrupt:
    extra_args: EXTRA_CONF_FILE="overlay-qcc74x-spi-interrupt.conf"
    platform_allow:
      - qcc748m_evk
```

## qcc74x_testing/tests/drivers/usb/pytest_cdc_acm/testcase.yaml
```yaml
# Copyright (c) Qualcomm Technologies, Inc. and/or its subsidiaries.
# SPDX-License-Identifier: BSD-3-Clause

common:
  tags: usb drivers cdc_acm
  platform_allow:
    - qcc748m_evk
  harness: pytest
  harness_config:
    pytest_root: ["scripts"]
    pytest_dut_scope: session
  timeout: 180

tests:
  qcc7xx.drivers.usb.cdc_acm:
    extra_args: DTC_OVERLAY_FILE=boards/qcc748m_evk.overlay
```

## qcc74x_testing/tests/drivers/usb/pytest_shell/testcase.yaml
```yaml
# Copyright (c) Qualcomm Technologies, Inc. and/or its subsidiaries.
# SPDX-License-Identifier: BSD-3-Clause

common:
  tags: usb shell
  platform_allow:
    - qcc748m_evk
  harness: pytest
  harness_config:
    pytest_root: ["scripts"]
    pytest_dut_scope: session
  timeout: 600

tests:
  qcc7xx.drivers.usb.shell:
    extra_args: DTC_OVERLAY_FILE=boards/qcc748m_evk.overlay
```

## qcc74x_testing/tests/drivers/usb/pytest_testusb/Kconfig
```kconfig
# Copyright (c) Qualcomm Technologies, Inc. and/or its subsidiaries.
# SPDX-License-Identifier: BSD-3-Clause

source "${ZEPHYR_BASE}/samples/subsys/usb/common/Kconfig.sample_usbd"
source "Kconfig.zephyr"
```

## qcc74x_testing/tests/drivers/usb/pytest_testusb/testcase.yaml
```yaml
# Copyright (c) Qualcomm Technologies, Inc. and/or its subsidiaries.
# SPDX-License-Identifier: BSD-3-Clause

common:
  tags: usb drivers testusb
  platform_allow:
    - qcc748m_evk
  harness: pytest
  harness_config:
    pytest_root: ["scripts"]
    pytest_dut_scope: session
  timeout: 1800

tests:
  qcc7xx.drivers.usb.testusb:
    extra_args: DTC_OVERLAY_FILE=boards/qcc748m_evk.overlay
```

## qcc74x_testing/tests/drivers/watchdog/wdt_basic_api/testcase.yaml
```yaml
# Copyright (c) 2026 Qualcomm Technologies, Inc. and/or its subsidiaries
# SPDX-License-Identifier: BSD-3-Clause

common:
  depends_on: watchdog
  expect_reboot: true
  tags:
    - drivers
    - watchdog
  platform_allow:
    - qcc748m_evk

tests:
  qcc7xx.drivers.watchdog: {}
```

## qcc74x_testing/tests/drivers/watchdog/wdt_l2/testcase.yaml
```yaml
# Copyright (c) Qualcomm Technologies, Inc. and/or its subsidiaries
# SPDX-License-Identifier: BSD-3-Clause

common:
  depends_on: watchdog
  expect_reboot: true
  tags:
    - drivers
    - watchdog
    - l2
  platform_allow:
    - qcc748m_evk

tests:
  qcc7xx.drivers.watchdog.l2: {}
```

## qcc74x_testing/tests/subsys/fota/ota_fs/testcase.yaml
```yaml
tests:
  qcc74x.fota.ota_fs:
    tags:
      - qcc74x
      - fota
      - littlefs
    platform_allow:
      - qcc748m_evk
    timeout: 600
    extra_args:
      DTC_OVERLAY_FILE="../../../../board_overlays/ota/qcc748m_evk.overlay"
```
