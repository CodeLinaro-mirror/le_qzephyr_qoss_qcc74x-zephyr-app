## prj.conf
```kconfig
# Copyright (c) 2024 Nordic Semiconductor ASA
# SPDX-License-Identifier: Apache-2.0

CONFIG_ZTEST=y
CONFIG_GPIO=y
CONFIG_COMPARATOR=y
CONFIG_PM_DEVICE=y
```

## boards/qcc748m_evk.overlay
```dts
/*
 * Copyright (c) 2026 Qualcomm Technologies, Inc. and/or its subsidiaries
 * SPDX-License-Identifier: BSD-3-Clause
 */

#include <zephyr/dt-bindings/gpio/gpio.h>

/ {
	aliases {
		test-comp = &comparator0;
	};

	zephyr,user {
		test-gpios = <&gpio0 20 GPIO_ACTIVE_HIGH>;
	};
};

&comparator0 {
	status = "okay";
	mux_enable;
	pos_chan_sel = "AON_ACOMP_CHAN_ADC0";
	neg_chan_sel = "AON_ACOMP_CHAN_VIO_X_SCALING_FACTOR_1";
	scaling_factor = "AON_ACOMP_SCALING_FACTOR_1";
	bias_prog = "AON_ACOMP_BIAS_POWER_MODE1";
	hysteresis_pos_volt = "AON_ACOMP_HYSTERESIS_VOLT_NONE";
	hysteresis_neg_volt = "AON_ACOMP_HYSTERESIS_VOLT_NONE";
};
```

## src/test.c
```c
/*
 * Copyright (c) 2024 Nordic Semiconductor ASA
 * Copyright 2026 NXP
 *
 * SPDX-License-Identifier: Apache-2.0
 */

#include <zephyr/drivers/comparator.h>
#include <zephyr/drivers/gpio.h>
#include <zephyr/kernel.h>
#include <zephyr/pm/device.h>
#include <zephyr/ztest.h>

static const struct device *test_dev = DEVICE_DT_GET(DT_ALIAS(test_comp));
static const struct gpio_dt_spec test_pin = GPIO_DT_SPEC_GET(DT_PATH(zephyr_user), test_gpios);
static K_SEM_DEFINE(test_sem, 0, 1);

static void test_callback(const struct device *dev, void *user_data)
{
	zassert_equal(&test_sem, user_data);
	k_sem_give(&test_sem);
}

static void *test_setup(void)
{
	zassert_ok(gpio_pin_configure_dt(&test_pin, GPIO_OUTPUT_INACTIVE));
	return NULL;
}

static void test_before(void *f)
{
	ARG_UNUSED(f);

	k_sem_reset(&test_sem);
	zassert_ok(gpio_pin_set_dt(&test_pin, 0));
	k_msleep(1);
	zassert_ok(comparator_set_trigger(test_dev, COMPARATOR_TRIGGER_NONE));
	zassert_ok(comparator_set_trigger_callback(test_dev, NULL, NULL));
	zassert_between_inclusive(comparator_trigger_is_pending(test_dev), 0, 1);
}

ZTEST_SUITE(comparator_gpio_loopback, NULL, test_setup, test_before, NULL, NULL);

ZTEST(comparator_gpio_loopback, test_get_output)
{
	zassert_equal(comparator_get_output(test_dev), 0);
	k_msleep(1);
	zassert_ok(gpio_pin_set_dt(&test_pin, 1));
	k_msleep(1);
	zassert_equal(comparator_get_output(test_dev), 1);
	k_msleep(1);
	zassert_ok(gpio_pin_set_dt(&test_pin, 0));
	k_msleep(1);
	zassert_equal(comparator_get_output(test_dev), 0);
}

ZTEST(comparator_gpio_loopback, test_no_trigger_no_pending)
{
	zassert_ok(gpio_pin_set_dt(&test_pin, 1));
	k_msleep(1);
	zassert_equal(comparator_trigger_is_pending(test_dev), 0);
	zassert_ok(gpio_pin_set_dt(&test_pin, 0));
	k_msleep(1);
	zassert_equal(comparator_trigger_is_pending(test_dev), 0);
}

ZTEST(comparator_gpio_loopback, test_trigger_rising_edge_pending)
{
	zassert_ok(comparator_set_trigger(test_dev, COMPARATOR_TRIGGER_RISING_EDGE));
	k_msleep(1);
	zassert_equal(comparator_trigger_is_pending(test_dev), 0);
	zassert_ok(gpio_pin_set_dt(&test_pin, 1));
	k_msleep(1);
	zassert_equal(comparator_trigger_is_pending(test_dev), 1);
	zassert_equal(comparator_trigger_is_pending(test_dev), 0);
	zassert_ok(gpio_pin_set_dt(&test_pin, 0));
	k_msleep(1);
	zassert_equal(comparator_trigger_is_pending(test_dev), 0);
}

ZTEST(comparator_gpio_loopback, test_trigger_falling_edge_pending)
{
	zassert_ok(comparator_set_trigger(test_dev, COMPARATOR_TRIGGER_FALLING_EDGE));
	k_msleep(1);
	zassert_equal(comparator_trigger_is_pending(test_dev), 0);
	zassert_ok(gpio_pin_set_dt(&test_pin, 1));
	k_msleep(1);
	zassert_equal(comparator_trigger_is_pending(test_dev), 0);
	zassert_ok(gpio_pin_set_dt(&test_pin, 0));
	k_msleep(1);
	zassert_equal(comparator_trigger_is_pending(test_dev), 1);
	zassert_equal(comparator_trigger_is_pending(test_dev), 0);
}

ZTEST(comparator_gpio_loopback, test_trigger_both_edges_pending)
{
	int rc = comparator_set_trigger(test_dev, COMPARATOR_TRIGGER_BOTH_EDGES);

	if (rc == -ENOTSUP) {
		/* If driver explicitly doesn't support BOTH — skip the test. */
		ztest_test_skip();
	}

	zassert_ok(rc);
	k_msleep(1);
	zassert_equal(comparator_trigger_is_pending(test_dev), 0);
	zassert_ok(gpio_pin_set_dt(&test_pin, 1));
	k_msleep(1);
	zassert_equal(comparator_trigger_is_pending(test_dev), 1);
	zassert_equal(comparator_trigger_is_pending(test_dev), 0);
	zassert_ok(gpio_pin_set_dt(&test_pin, 0));
	k_msleep(1);
	zassert_equal(comparator_trigger_is_pending(test_dev), 1);
	zassert_equal(comparator_trigger_is_pending(test_dev), 0);
}

ZTEST(comparator_gpio_loopback, test_trigger_callback)
{
	zassert_ok(comparator_set_trigger_callback(test_dev, test_callback, &test_sem));
	k_msleep(1);
	zassert_equal(k_sem_take(&test_sem, K_NO_WAIT), -EBUSY);
	zassert_ok(comparator_set_trigger(test_dev, COMPARATOR_TRIGGER_RISING_EDGE));
	k_msleep(1);
	zassert_equal(k_sem_take(&test_sem, K_NO_WAIT), -EBUSY);
	zassert_ok(gpio_pin_set_dt(&test_pin, 1));
	k_msleep(1);
	zassert_ok(k_sem_take(&test_sem, K_NO_WAIT));
	zassert_equal(comparator_trigger_is_pending(test_dev), 0);
}

#ifdef CONFIG_PM_DEVICE
ZTEST(comparator_gpio_loopback, test_suspend_resume_restores_trigger)
{
	enum pm_device_state state;

	zassert_ok(gpio_pin_set_dt(&test_pin, 0));
	k_msleep(1);
	zassert_ok(comparator_set_trigger(test_dev, COMPARATOR_TRIGGER_FALLING_EDGE));
	zassert_ok(pm_device_action_run(test_dev, PM_DEVICE_ACTION_SUSPEND));
	zassert_ok(pm_device_state_get(test_dev, &state));
	zassert_equal(state, PM_DEVICE_STATE_SUSPENDED);
	/* A configuration change while suspended must be applied by resume. */
	zassert_ok(comparator_set_trigger(test_dev, COMPARATOR_TRIGGER_RISING_EDGE));

	zassert_ok(pm_device_action_run(test_dev, PM_DEVICE_ACTION_RESUME));
	zassert_ok(pm_device_state_get(test_dev, &state));
	zassert_equal(state, PM_DEVICE_STATE_ACTIVE);
	zassert_equal(comparator_trigger_is_pending(test_dev), 0);

	zassert_ok(gpio_pin_set_dt(&test_pin, 1));
	k_msleep(1);
	zassert_equal(comparator_get_output(test_dev), 1);
	zassert_equal(comparator_trigger_is_pending(test_dev), 1);
}
#endif /* CONFIG_PM_DEVICE */
```
