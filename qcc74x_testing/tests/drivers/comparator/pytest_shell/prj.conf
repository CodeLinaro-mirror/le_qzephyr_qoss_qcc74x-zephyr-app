## CMakeLists.txt
```
# Copyright (c) Qualcomm Technologies, Inc. and/or its subsidiaries
# SPDX-License-Identifier: BSD-3-Clause

cmake_minimum_required(VERSION 3.20.0)
find_package(Zephyr REQUIRED HINTS $ENV{ZEPHYR_BASE})
project(qcc74x_acomp_pytest_shell)

target_sources(app PRIVATE src/main.c)
```

## prj.conf
```kconfig
# Copyright (c) Qualcomm Technologies, Inc. and/or its subsidiaries
# SPDX-License-Identifier: BSD-3-Clause

CONFIG_CONSOLE=y
CONFIG_SERIAL=y
CONFIG_UART_CONSOLE=y
CONFIG_SHELL=y
CONFIG_SHELL_PROMPT_UART="qcc74x:~$"
CONFIG_SHELL_VT100_COLORS=n

CONFIG_GPIO=y
CONFIG_COMPARATOR=y
CONFIG_QCOM_ACOMP_SHELL=y
```

## boards/qcc748m_evk.overlay
```dts
/*
 * Copyright (c) Qualcomm Technologies, Inc. and/or its subsidiaries
 * SPDX-License-Identifier: BSD-3-Clause
 */

#include <zephyr/dt-bindings/gpio/gpio.h>

/ {
	zephyr,user {
		acomp-drive-gpios = <&gpio0 20 GPIO_ACTIVE_HIGH>;
	};
};

&comparator0 {
	status = "okay";
	mux_enable;
	pos_chan_sel = "AON_ACOMP_CHAN_ADC0";
	neg_chan_sel = "AON_ACOMP_CHAN_VIO_X_SCALING_FACTOR_1";
	scaling_factor = "AON_ACOMP_SCALING_FACTOR_1";
	bias_prog = "AON_ACOMP_BIAS_POWER_MODE1";
	hysteresis_pos_volt = "AON_ACOMP_HYSTERESIS_VOLT_NONE";
	hysteresis_neg_volt = "AON_ACOMP_HYSTERESIS_VOLT_NONE";
};

&comparator1 {
	status = "okay";
	mux_enable;
	pos_chan_sel = "AON_ACOMP_CHAN_ADC0";
	neg_chan_sel = "AON_ACOMP_CHAN_VIO_X_SCALING_FACTOR_1";
	scaling_factor = "AON_ACOMP_SCALING_FACTOR_1";
	bias_prog = "AON_ACOMP_BIAS_POWER_MODE1";
	hysteresis_pos_volt = "AON_ACOMP_HYSTERESIS_VOLT_NONE";
	hysteresis_neg_volt = "AON_ACOMP_HYSTERESIS_VOLT_NONE";
};
```

## src/main.c
```c
/*
 * Copyright (c) Qualcomm Technologies, Inc. and/or its subsidiaries
 * SPDX-License-Identifier: BSD-3-Clause
 */

int main(void)
{
	return 0;
}
```
