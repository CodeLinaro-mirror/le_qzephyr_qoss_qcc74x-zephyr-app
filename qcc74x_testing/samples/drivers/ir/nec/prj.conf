## CMakeLists.txt
```
# Copyright (c) 2026 Qualcomm Technologies, Inc. and/or its subsidiaries
# SPDX-License-Identifier: BSD-3-Clause

cmake_minimum_required(VERSION 3.20.0)
find_package(Zephyr REQUIRED HINTS $ENV{ZEPHYR_BASE})
project(sample_ir_nec)

target_sources(app PRIVATE src/main.c)
target_sources(app PRIVATE ${ZEPHYR_HAL_QCOM_MODULE_DIR}/drivers/lhal/src/qc7xx_ir.c)
```

## sample.yaml
```
sample:
  description: A sample application to receive IR (infrared) data using NEC protocol.
  name: ir_nec_sample
tests:
  sample.drivers.ir.nec:
    tags: ir
    depends_on: ir
    harness: console
    harness_config:
      type: multi_line
      regex:
        - "Press any button in NEC remote contoller"
        - "IR data received: x[0-9a-fA-F]+"
    platform_allow:
      - qcc748m_evk
```

## prj.conf
```kconfig
# Copyright (c) 2026 Qualcomm Technologies, Inc. and/or its subsidiaries
# SPDX-License-Identifier: BSD-3-Clause

CONFIG_IR=y

# Enable logging
CONFIG_PRINTK=y
CONFIG_LOG=y
CONFIG_LOG_BACKEND_UART=y
CONFIG_UART_CONSOLE=y

# General settings
CONFIG_STDOUT_CONSOLE=y
CONFIG_MAIN_STACK_SIZE=1024
```

## boards/qcc748m_evk.overlay
```dts
/*
 * Copyright (c) 2026 Qualcomm Technologies, Inc. and/or its subsidiaries
 * SPDX-License-Identifier: BSD-3-Clause
 */

&pinctrl {
	status = "okay";
	ir_default: ir_default {
		group1 {
			pinmux = <IR_RX_GPIO10>;
		};
	};
};

&ir {
	status = "okay";
	rx_mode = "IR_RX_NEC";
	input_inverse;
	pinctrl-0 = <&ir_default>;
	pinctrl-names = "default";
};
```

## src/main.c
```c
/*
 * Copyright (c) 2026 Qualcomm Technologies, Inc. and/or its subsidiaries
 *
 * SPDX-License-Identifier: BSD-3-Clause
 */

#include <stdlib.h>
#include <time.h>

#include <zephyr/kernel.h>
#include <zephyr/logging/log.h>

#include <zephyr/drivers/ir.h>

int main()
{
	static const struct device *ir = DEVICE_DT_GET(DT_NODELABEL(ir));
	uint64_t data;

	if (!ir) {
		printk("Cannot access IR device\n");
		return -1;
	}

	if (!device_is_ready(ir)) {
		printk("IR device not ready\n");
		return -1;
	}

	printk("Press any button in NEC remote contoller \n");
	k_msleep(100);

	ir_receive(ir, &data);
	printk("IR data received: x%016llx\n", data);

	return 0;
}
```
