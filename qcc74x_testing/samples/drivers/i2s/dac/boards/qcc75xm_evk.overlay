/*
 * Copyright (c) 2026 Qualcomm Technologies, Inc. and/or its subsidiaries
 *
 * SPDX-License-Identifier: BSD-3-Clause
 */

#include "qcc74xm_evk_common.dtsi"

&pinctrl {
	i2s0_default: i2s0_default {
		group1 {
			pinmux = <GPIO16_I2S_BCLK>,
				<GPIO17_I2S_FS>,
				<GPIO18_I2S_DI>,
				<GPIO19_I2S_DO>;
			input-enable;
		};
	};
};
