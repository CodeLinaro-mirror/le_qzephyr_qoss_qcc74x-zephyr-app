## CMakeLists.txt
```
# Copyright (c) 2026 Qualcomm Technologies, Inc. and/or its subsidiaries
# SPDX-License-Identifier: BSD-3-Clause

cmake_minimum_required(VERSION 3.20.0)
find_package(Zephyr REQUIRED HINTS $ENV{ZEPHYR_BASE})
project(i2c_lm75_test)

target_sources(app PRIVATE src/main.c)
```

## sample.yaml
```
# Copyright (c) 2026 Qualcomm Technologies, Inc. and/or its subsidiaries
# SPDX-License-Identifier: Apache-2.0

tests:
  qcc7xx.sample.sensor.lm75.i2c:
    build_only: true
    platform_allow:
      - qcc743m_evk
      - qcc744m_evk
      - qcc748m_evk
      - qcc75xm_evk
```

## prj.conf
```kconfig
# Copyright (c) 2026 Qualcomm Technologies, Inc. and/or its subsidiaries
# SPDX-License-Identifier: BSD-3-Clause

CONFIG_I2C=y

# Enable logging
CONFIG_LOG=y
CONFIG_PRINTK=y
CONFIG_CBPRINTF_FP_SUPPORT=y
CONFIG_I2C_LOG_LEVEL_WRN=y
```

## boards/qcc743m_evk.overlay
```dts
/*
 * Copyright (c) 2026 Qualcomm Technologies, Inc. and/or its subsidiaries
 *
 * SPDX-License-Identifier: BSD-3-Clause
 */

&pinctrl {
	status = "okay";
	i2c0_default: i2c0_default {
	group1 {
		pinmux = <GPIO30_I2C0_SCL>,
			<GPIO29_I2C0_SDA>;
		bias-pull-up;
		drive-strength = <1>;
		input-schmitt-enable;
		input-enable;
		};
	};
};

&i2c0 {
	status = "okay";
	clock-frequency = <I2C_BITRATE_FAST>;
	pinctrl-0 = <&i2c0_default>;
	pinctrl-names = "default";
};
```

## boards/qcc744m_evk.overlay
```dts
/*
 * Copyright (c) 2026 Qualcomm Technologies, Inc. and/or its subsidiaries
 *
 * SPDX-License-Identifier: BSD-3-Clause
 */

&pinctrl {
	status = "okay";
	i2c0_default: i2c0_default {
	group1 {
		pinmux = <GPIO18_I2C0_SCL>,
			<GPIO19_I2C0_SDA>;
			bias-pull-up;
			drive-strength = <1>;
			input-schmitt-enable;
			input-enable;
		};
	};
};

&i2c0 {
	status = "okay";
	clock-frequency = <I2C_BITRATE_STANDARD>;
	pinctrl-0 = <&i2c0_default>;
	pinctrl-names = "default";
};
```

## boards/qcc748m_evk.overlay
```dts
/*
 * Copyright (c) 2026 Qualcomm Technologies, Inc. and/or its subsidiaries
 *
 * SPDX-License-Identifier: BSD-3-Clause
 */

&pinctrl {
	status = "okay";
	i2c0_default: i2c0_default {
	group1 {
		pinmux = <I2C0_SCL_GPIO18>,
			<I2C0_SDA_GPIO19>;
			bias-pull-up;
			drive-strength = <1>;
			input-schmitt-enable;
			input-enable;
		};
	};
};

&i2c0 {
	status = "okay";
	clock-frequency = <I2C_BITRATE_STANDARD>;
	pinctrl-0 = <&i2c0_default>;
	pinctrl-names = "default";
};
```

## boards/qcc75xm_evk.overlay
```dts
/*
 * Copyright (c) 2026 Qualcomm Technologies, Inc. and/or its subsidiaries
 *
 * SPDX-License-Identifier: BSD-3-Clause
 */

&pinctrl {
	status = "okay";
	i2c0_default: i2c0_default {
	group1 {
		pinmux = <GPIO16_I2C0_SCL>,
			<GPIO17_I2C0_SDA>;
			bias-pull-up;
			drive-strength = <1>;
			input-schmitt-enable;
			input-enable;
		};
	};
};

&i2c0 {
	status = "okay";
	clock-frequency = <I2C_BITRATE_STANDARD>;
	pinctrl-0 = <&i2c0_default>;
	pinctrl-names = "default";
};
```

## src/main.c
```c
/*
 * Copyright (c) 2026 Qualcomm Technologies, Inc. and/or its subsidiaries
 * SPDX-License-Identifier: Apache-2.0
 */

#include <zephyr/device.h>
#include <zephyr/drivers/i2c.h>
#include <zephyr/kernel.h>

#define LM75_ADDR     0x48
#define LM75_TEMP_REG 0x00

static const struct device *i2c_dev = DEVICE_DT_GET(DT_NODELABEL(i2c0));

static float read_lm75_temperature(void)
{
	uint8_t buffer[2];
	int ret;

	if (!device_is_ready(i2c_dev)) {
		printf("I2C Is Not Ready.\n");
		return -1;
	}

	ret = i2c_burst_read(i2c_dev, LM75_ADDR, LM75_TEMP_REG, buffer, sizeof(buffer));
	if (ret) {
		printf("I2C Read Err: %d\n", ret);
		return -1;
	}

	int16_t temp = (buffer[0] << 8) | buffer[1];
	return (temp >> 5) * 0.125f;
}

int main(void)
{
	printf("Read Temperature From LM75 By I2C\n");

	while (1) {
		float temp = read_lm75_temperature();
		printf("Now Temp: %.2f degrees Celsius\n", (double)temp);
		k_sleep(K_MSEC(2000));
	}

	return 0;
}
```
