/*
 * Copyright (c) 2026 Qualcomm Technologies, Inc. and/or its subsidiaries
 * SPDX-License-Identifier: BSD-3-Clause
 */

&timer0 {
	status = "okay";
	clock-div = <39>;
	start-at-init = <0>;
};

&timer1 {
	status = "okay";
	clock-div = <39>;
	start-at-init = <0>;
};
