/*
 * Copyright (c) 2026 Qualcomm Technologies, Inc. and/or its subsidiaries
 * SPDX-License-Identifier: BSD-3-Clause
 */

/ {
	aliases {
		rtc-0 = &timer0;
	};
};

&timer0 {
	status = "okay";
	clock-div = <99>;
	start-at-init = <1>;
};
