/*
 * Copyright (c) 2025 Qualcomm Technologies, Inc. and/or its subsidiaries
 *
 * SPDX-License-Identifier: Apache-2.0
 */

zephyr_udc0: &usb {
	status = "okay";
};

/ {
	usb_midi: usb_midi {
		compatible = "zephyr,midi2-device";
		status = "okay";
		#address-cells = <1>;
		#size-cells = <1>;

		midi_in_out@0 {
			reg = <0 1>;
			protocol = "midi1-up-to-128b";
		};
	};
};