## CMakeLists.txt
```
# Copyright (c) 2026 Qualcomm Technologies, Inc. and/or its subsidiaries
# SPDX-License-Identifier: BSD-3-Clause

cmake_minimum_required(VERSION 3.20.0)

find_package(Zephyr REQUIRED HINTS $ENV{ZEPHYR_BASE})
project(wifi)

FILE(GLOB app_sources ${ZEPHYR_BASE}/samples/net/wifi/shell/src/*.c)
target_sources(app PRIVATE ${app_sources})
target_sources_ifdef(CONFIG_WIFI_SHELL_COEX_VALIDATION app PRIVATE
  src/qcc74x_coex_shell.c
)
```

## Kconfig
```
# Copyright (c) 2026 Qualcomm Technologies, Inc. and/or its subsidiaries
# SPDX-License-Identifier: BSD-3-Clause

menu "Zephyr"
source "Kconfig.zephyr"
endmenu

menu "QCC74x Coex Validation"

config WIFI_SHELL_COEX_VALIDATION
	bool "Enable QCC74x Wi-Fi/BLE coexistence validation commands"
	depends on SHELL && QCC74X_WIFI_COEX
	default n
	help
	  Enable the qcc74x_coex shell command group used to validate the
	  sample-level QCC74X Wi-Fi/BLE coexistence runtime.

endmenu
```

## prj.conf
```kconfig
CONFIG_EARLY_CONSOLE=y

CONFIG_NETWORKING=y
CONFIG_TEST_RANDOM_GENERATOR=y

CONFIG_MAIN_STACK_SIZE=5200
CONFIG_SHELL_STACK_SIZE=5200
CONFIG_NET_TX_STACK_SIZE=2048
CONFIG_NET_RX_STACK_SIZE=2048

CONFIG_NET_PKT_RX_COUNT=10
CONFIG_NET_PKT_TX_COUNT=10
CONFIG_NET_BUF_RX_COUNT=20
CONFIG_NET_BUF_TX_COUNT=20
CONFIG_NET_MAX_CONTEXTS=10
CONFIG_NET_DHCPV4=y

CONFIG_NET_IPV4=y
CONFIG_NET_IPV6=n

CONFIG_NET_TCP=y

CONFIG_NET_LOG=y
CONFIG_INIT_STACKS=y

CONFIG_NET_SHELL=y

CONFIG_NET_STATISTICS=y
CONFIG_NET_STATISTICS_PERIODIC_OUTPUT=n

CONFIG_WIFI=y
CONFIG_WIFI_LOG_LEVEL_ERR=y
CONFIG_NET_L2_WIFI_SHELL=y
# printing of scan results puts pressure on queues in new locking
# design in net_mgmt. So, use a higher timeout for a crowded
# environment.
CONFIG_NET_MGMT_EVENT_QUEUE_TIMEOUT=5000
CONFIG_NET_MGMT_EVENT_QUEUE_SIZE=16

# PSRAM: enable 4MB PSRAM with code-copy support on qcc748.
CONFIG_FLASH_XIP_LENGTH=0x400000
CONFIG_PSRAM=y
CONFIG_PSRAM_LENGTH=0x400000
CONFIG_PSRAM_COPY_CODE=y
CONFIG_NET_PKT_TX_COUNT=32
CONFIG_NET_BUF_TX_COUNT=36
CONFIG_SOC_WIFI_STA_RECONNECT=y

CONFIG_NET_CONTEXT_RCVBUF=y
CONFIG_QCC74X_TCP_OTA=y
CONFIG_SOC_FLASH_QCC74X=y
```

## overlay-ble-lowpower.conf
```kconfig
# QCC74x BLE + WiFi joint low-power overlay.
# Stack with overlay-lowpower.conf: `-DEXTRA_CONF_FILE="overlay-lowpower.conf;overlay-ble-lowpower.conf"`.

# Bluetooth host + controller
CONFIG_BT=y
CONFIG_BT_PERIPHERAL=y
CONFIG_BT_BROADCASTER=y
CONFIG_BT_SHELL=y

CONFIG_BT_DEVICE_NAME="qcc74x-lp"
CONFIG_BT_GAP_AUTO_UPDATE_CONN_PARAMS=y
# 160 * 1.25ms = 200ms, 320 * 1.25ms = 400ms
CONFIG_BT_PERIPHERAL_PREF_MIN_INT=160
CONFIG_BT_PERIPHERAL_PREF_MAX_INT=320
CONFIG_BT_PERIPHERAL_PREF_LATENCY=4
CONFIG_BT_PERIPHERAL_PREF_TIMEOUT=600

# btblecontroller 1.6.119 lacks HCI_Host_Buffer_Size opcode 0x0c33;
# disable host-side ACL flow control or bt_enable() returns -5.
CONFIG_BT_HCI_ACL_FLOW_CONTROL=n

# Engage BLE side of PDS15
CONFIG_QCC74X_PM_PDS15_BLE=y

# BLE + WiFi protocol stacks need ~28-30K heap (50K overruns RAM).
CONFIG_HEAP_MEM_POOL_SIZE=28672
CONFIG_BT_TX_PROCESSOR_STACK_SIZE=768
CONFIG_BT_BUF_EVT_RX_COUNT=4
CONFIG_BT_BUF_EVT_DISCARDABLE_COUNT=1

# Keep the full Wi-Fi runtime path, but use the validated minimum network
# packet pools from the previous BLE + Wi-Fi PDS15 image. The qcc74x default
# pools (16/24 packets and 16/24 buffers) consume too much on-chip SRAM for
# this combined low-power image.
CONFIG_NET_PKT_RX_COUNT=8
CONFIG_NET_PKT_TX_COUNT=14
CONFIG_NET_BUF_RX_COUNT=8
CONFIG_NET_BUF_TX_COUNT=16
```

## overlay-coex.conf
```kconfig
CONFIG_QCC74X_WIFI_COEX=y
CONFIG_WIFI_SHELL_COEX_VALIDATION=y
```

## overlay-lowpower.conf
```kconfig
# QCC74x generic low-power overlay for qcc74x wifi/shell validation.
#
# This is the only maintained low-power overlay. It covers the current
# PDS15/LPFW/Wi-Fi low-power path, including Wi-Fi connected resume.
# Do not add new stage-specific overlays; update this file instead.

# System PM / PDS15
CONFIG_PM=y
CONFIG_PM_POLICY_CUSTOM=y
CONFIG_PM_CPU_SHELL=y
CONFIG_PM_DEVICE=y
CONFIG_PM_NEED_ALL_DEVICES_IDLE=n
CONFIG_PM_DEVICE_SYSTEM_MANAGED=y
CONFIG_GPIO=y
CONFIG_PSRAM=n
CONFIG_RISCV_MACHINE_TIMER=n

CONFIG_QCC74X_PM_PDS15=y

# Explicit HBN system-off validation. HBN remains independent from the
# automatic PDS15 policy and is entered only through the hbn shell command.
CONFIG_POWEROFF=y
CONFIG_QCC74X_HBN_SHELL=y

# QCC74x Wi-Fi low-power
CONFIG_QCC74X_WIFI_LOW_POWER=y

# Validation shell / diagnostics
CONFIG_QCC74X_PM_DIAGNOSTICS=y
CONFIG_QCC74X_PM_PDS15_LOG_LEVEL_OFF=y
CONFIG_WIFI_SHELL_LOWPOWER_VALIDATION=y

# Minimal runtime requirements
CONFIG_THREAD_LOCAL_STORAGE=y
CONFIG_CURRENT_THREAD_USE_TLS=y
CONFIG_SHELL_PROMPT_UART="qcc74x:~$"
CONFIG_LOG_MODE_DEFERRED=y
CONFIG_LOG_RUNTIME_FILTERING=n
CONFIG_PRINTK=y

# The current qcc74x_devkitp validation image keeps Zephyr RAM in on-chip
# SRAM, so trim the heap while preserving the Wi-Fi/PDS15 flow.
CONFIG_HEAP_MEM_POOL_SIZE=26624

CONFIG_NET_PKT_TX_COUNT=24
CONFIG_NET_BUF_TX_COUNT=24
```

## overlay-wifi-throughput.conf
```kconfig
# PSRAM: enable 4MB PSRAM with code-copy support on qcc748.
CONFIG_FLASH_XIP_LENGTH=0x400000
CONFIG_PSRAM=y
CONFIG_PSRAM_LENGTH=0x400000
CONFIG_PSRAM_COPY_CODE=y

# Higher TX buffer counts for throughput (RvR/tput) testing. NOT the default —
# at 32/36 with CONFIG_ZPERF_SESSION_PER_THREAD=n these values
# exhausted OCRAM at boot on constrained builds. Only apply this overlay when
# running throughput tests; the base socs/qcc748.conf default is 24/24.
CONFIG_NET_PKT_TX_COUNT=32
CONFIG_NET_BUF_TX_COUNT=36
```

## socs/qcc748.conf
```kconfig
# ==================== Shell Configuration ====================
# Shell stack size is owned by the application prj.conf.  In particular, the
# TCP OTA command needs more stack than the generic shell default.
# Reopen / startup on this bench can deliver a short RX burst before the shell
# thread drains input, so keep more headroom than the generic default (64).
CONFIG_SHELL_BACKEND_SERIAL_RX_RING_BUFFER_SIZE=128
# Shell prompt setting
CONFIG_SHELL_PROMPT_UART="qcc74x:~$"
#not defined yet
#CONFIG_ETH_QC7XX_EMAC=n

# ==================== Network Buffers & Interfaces ====================
# Number of RX packets
CONFIG_NET_PKT_RX_COUNT=16
# Number of TX packets
CONFIG_NET_PKT_TX_COUNT=32
# Network buffer pool size (RX)
CONFIG_NET_BUF_RX_COUNT=16
# Network buffer pool size (TX)
CONFIG_NET_BUF_TX_COUNT=36
# Max IPv4 addresses per interface
CONFIG_NET_IF_MAX_IPV4_COUNT=2
# Max IPv6 addresses per interface
CONFIG_NET_IF_MAX_IPV6_COUNT=2
# Enable Ethernet L2
CONFIG_NET_L2_ETHERNET=y
CONFIG_NET_BUF_DATA_SIZE=1600
CONFIG_NET_BUF_POOL_USAGE=y
CONFIG_NET_BUF_LOG=y

CONFIG_NET_TX_STACK_SIZE=4096
CONFIG_NET_RX_STACK_SIZE=4096

CONFIG_NET_TCP_WORKQ_STACK_SIZE=2048
# ==================== Network Management ====================
# Net management event queue size
CONFIG_NET_MGMT_EVENT_QUEUE_SIZE=10
# Net management event handler stack size
CONFIG_NET_MGMT_EVENT_STACK_SIZE=8192
# Enable network connection manager
CONFIG_NET_CONNECTION_MANAGER=y
CONFIG_NET_CONNECTION_MANAGER_MONITOR_STACK_SIZE=2048

# ==================== Ethernet Driver ====================
# Keep the WiFi shell sample off the EMAC path for now.
# CONFIG_ETH_DRIVER is not set
# CONFIG_ETH_PHY_DRIVER is not set

# ==================== IPv4 & DHCPv4 ====================
# Number of DHCPv4 server addresses
CONFIG_NET_DHCPV4_SERVER_ADDR_COUNT=4
# ICMP probe timeout for DHCPv4 (ms)
CONFIG_NET_DHCPV4_SERVER_ICMP_PROBE_TIMEOUT=1000
# Enable DHCPv4 server
CONFIG_NET_DHCPV4_SERVER=y
# Enable DHCPv4 DNS address option
CONFIG_NET_DHCPV4_OPTION_DNS_ADDRESS=y
# DHCPv4 server log level: debug
CONFIG_NET_DHCPV4_SERVER_LOG_LEVEL_DBG=y

# ==================== IPv6 & DHCPv6 ====================
# Enable IPv6 protocol
CONFIG_NET_IPV6=y
# Enable RDNSS option in IPv6 RA
CONFIG_NET_IPV6_RA_RDNSS=y
# Enable DHCPv6 DNS address option
CONFIG_NET_DHCPV6_OPTION_DNS_ADDRESS=y

# ==================== Sockets & TLS/DTLS ====================
# Keep the sample on the plain sockets path on Zephyr 4.3.
# CONFIG_NET_SOCKETS_SOCKOPT_TLS is not set
# CONFIG_NET_SOCKETS_ENABLE_DTLS is not set
# DNS query timeout (ms)
CONFIG_NET_SOCKETS_DNS_TIMEOUT=2000
# DNS backoff interval (ms)
CONFIG_NET_SOCKETS_DNS_BACKOFF_INTERVAL=5000
# Enable Sockets service
CONFIG_NET_SOCKETS_SERVICE=y
# Service thread priority
CONFIG_NET_SOCKETS_SERVICE_THREAD_PRIO=15
# Service thread stack size
CONFIG_NET_SOCKETS_SERVICE_STACK_SIZE=4096

# ==================== DNS Resolver ====================
CONFIG_DNS_RESOLVER=y

# ==================== Network Test Tool ====================
# Enable zperf performance testing
CONFIG_NET_ZPERF=y
CONFIG_NET_ZPERF_SERVER=y
CONFIG_NET_ZPERF_MAX_SESSIONS=6
# fix: per-session threads consume ~44KB of OCRAM heap in per-session
# work-queue stacks, shrinking the soc_multi_heap "ocram" heap from ~98KB to
# ~46KB. This forces wifi k_thread allocations to overflow into the "wram"
# heap (_heap_wifi, WRAM), whose contents are NOT retained across PDS15 deep
# sleep -- so a wifi thread's timeout node still linked on the kernel
# timeout_list gets poisoned during sleep and the wake path crashes in
# sys_clock_announce_locked. Set =n to match BL and reclaim OCRAM headroom.
CONFIG_ZPERF_SESSION_PER_THREAD=n
CONFIG_ZPERF_WORK_Q_STACK_SIZE=4096
CONFIG_NET_ZPERF_MAX_PACKET_SIZE=1500

# ==================== Statistics ====================
# Enable named statistics
CONFIG_STATS_NAMES=y
# Enable stats in shell
CONFIG_STATS_SHELL=y
# Enable statistics
CONFIG_STATS=y
# Enable network statistics shell commands
CONFIG_NET_STATISTICS_USER_API=y

# ==================== WiFi Configuration ====================
# QCC74X WiFi driver
CONFIG_WIFI_QCC74X=y
# AP & STA mode support
CONFIG_QC7XX_WIFI_AP_STA_MODE=y
# STA mode auto DHCPv4
CONFIG_QC7XX_WIFI_STA_AUTO_DHCPV4=y
# WiFi network manager
CONFIG_WIFI_NM=y
# Max managed interfaces
CONFIG_WIFI_NM_MAX_MANAGED_INTERFACES=4
# Shell max AP/STA interfaces
CONFIG_WIFI_SHELL_MAX_AP_STA=4

# ==================== Threads & Workqueue ====================
# Main stack size
CONFIG_MAIN_STACK_SIZE=4096
# System workqueue stack size
CONFIG_SYSTEM_WORKQUEUE_STACK_SIZE=6144
# Dynamic threads support
CONFIG_DYNAMIC_THREAD=y
CONFIG_DYNAMIC_THREAD_ALLOC=y
CONFIG_DYNAMIC_THREAD_PREFER_POOL=y
# Runtime statistics
CONFIG_THREAD_RUNTIME_STATS=y
CONFIG_THREAD_RUNTIME_STATS_USE_TIMING_FUNCTIONS=y
# Thread info & monitoring
CONFIG_THREAD_STACK_INFO=y
CONFIG_THREAD_MONITOR=y
CONFIG_THREAD_NAME=y
CONFIG_THREAD_CUSTOM_DATA=y
# Initialize all thread stacks
CONFIG_INIT_STACKS=y

# ==================== Memory & Heap ====================
# Heap memory pool size
CONFIG_HEAP_MEM_POOL_SIZE=32708
# Sys heap runtime stats
CONFIG_SYS_HEAP_RUNTIME_STATS=y
# Shared multi-heap support
CONFIG_SHARED_MULTI_HEAP=y
# ==================== mbedTLS / PSA Crypto ====================
# Zephyr 4.3 moved most legacy mbedTLS feature toggles behind PSA wants.
# Keep TLS sockets disabled above, but still link the crypto pieces used
# by the QC7XX wireless HAL blob.
CONFIG_MBEDTLS=y
# Use QCC74x soc_multi_heap via mbedtls_platform_set_calloc_free().
# CONFIG_MBEDTLS_ENABLE_HEAP is not set
CONFIG_MBEDTLS_PSA_STATIC_KEY_SLOTS=n
CONFIG_PSA_CRYPTO=y
CONFIG_PSA_CRYPTO_PROVIDER_MBEDTLS=y
CONFIG_PSA_CRYPTO_ENABLE_ALL=y
CONFIG_MBEDTLS_MD_C=y
CONFIG_MBEDTLS_ENTROPY_C=y
CONFIG_MBEDTLS_CTR_DRBG_C=y
CONFIG_MBEDTLS_PSA_DRIVER_GET_ENTROPY=y
CONFIG_MBEDTLS_PSA_CRYPTO_LEGACY_RNG=y
CONFIG_MBEDTLS_PK_WRITE_C=y
CONFIG_MBEDTLS_PKCS5_C=y
CONFIG_MBEDTLS_PEM_PARSE_C=y
CONFIG_MBEDTLS_ECP_NIST_OPTIM=y
CONFIG_MBEDTLS_AES_ROM_TABLES=y

# ==================== CRC & File System ====================
CONFIG_CRC=y
CONFIG_ZVFS_POLL_MAX=15

# ==================== Logging & Commands ====================
CONFIG_LOG=y
# Enable log commands
CONFIG_LOG_CMDS=y
CONFIG_NET_LOG=y

CONFIG_NET_CONFIG_LOG_LEVEL_DBG=y
#CONFIG_NET_PKT_LOG_LEVEL_DBG=y
#CONFIG_NET_IPV4_LOG_LEVEL_DBG=y
#CONFIG_NET_UDP_LOG_LEVEL_DBG=y
#CONFIG_NET_TCP_LOG_LEVEL_DBG=y
#CONFIG_NET_SOCKETS_LOG_LEVEL_DBG=y
#CONFIG_NET_ZPERF_LOG_LEVEL_DBG=y
CONFIG_NET_ZPERF_LOG_LEVEL_INF=y

# ==================== Core Dump & Debug ====================
CONFIG_DEBUG_COREDUMP=y
CONFIG_DEBUG_COREDUMP_BACKEND_LOGGING=y
CONFIG_DEBUG_COREDUMP_MEMORY_DUMP_MIN=y
CONFIG_DEBUG_COREDUMP_SHELL=y
CONFIG_SYMTAB=y
CONFIG_SYMTAB_SHELL=y
CONFIG_TRACING=y
CONFIG_DEBUG_THREAD_INFO=n
CONFIG_THREAD_ANALYZER=y
CONFIG_COREDUMP_DEVICE=y

# ==================== POSIX Support ====================
CONFIG_POSIX_API=y
CONFIG_POSIX_TIMERS=y
CONFIG_REQUIRES_FLOAT_PRINTF=y
CONFIG_PICOLIBC_IO_FLOAT=y

# ==================== Miscellaneous ====================
# Reboot support
CONFIG_REBOOT=y
```

## src/lp_pds_shell.c
```c
/*
 * Copyright (c) 2026 Qualcomm Technologies, Inc. and/or its subsidiaries
 * SPDX-License-Identifier: BSD-3-Clause
 */

#include <errno.h>
#include <stdbool.h>
#include <stdint.h>
#include <stdlib.h>
#include <string.h>

#include <zephyr/init.h>
#include <zephyr/kernel.h>
#include <zephyr/pm/policy.h>
#include <zephyr/shell/shell.h>
#include <zephyr/soc/qualcomm/qcc74x_pm_diag.h>
#include <zephyr/soc/qualcomm/qcc74x_pm_pds15.h>
#include <zephyr/soc/qualcomm/qcc74x_pm_pds15_diag.h>

#include <qc7xx_lp.h>

#if defined(CONFIG_WIFI_SHELL_LOWPOWER_VALIDATION)
static uint64_t lp_pds_ms_to_us(uint32_t ms)
{
	return (uint64_t)ms * USEC_PER_MSEC;
}

static uint64_t lp_pds_ratio_pct_x100(uint64_t part_us, uint64_t total_us)
{
	if ((total_us == 0U) || (part_us == 0U)) {
		return 0U;
	}

	return (part_us * 10000ULL) / total_us;
}

static const char *lp_pds_deep_skip_reason_name(uint32_t reason)
{
	switch (reason) {
	case QCC74X_PM_DEEP_SKIP_REASON_NOT_ARMED:
		return "not_armed";
	case QCC74X_PM_DEEP_SKIP_REASON_ENTER_BUSY:
		return "enter_busy";
	case QCC74X_PM_DEEP_SKIP_REASON_DEADLINE_REACHED:
		return "deadline_reached";
	case QCC74X_PM_DEEP_SKIP_REASON_NEXT_TIMEOUT_IMMEDIATE:
		return "next_timeout_immediate";
	case QCC74X_PM_DEEP_SKIP_REASON_NO_WAKE_SOURCE:
		return "no_wake_source";
	case QCC74X_PM_DEEP_SKIP_REASON_WIFI_BLOCKED:
		return "wifi_blocked";
	case QCC74X_PM_DEEP_SKIP_REASON_BLE_BLOCKED:
		return "ble_blocked";
	default:
		return "none";
	}
}

static const char *lp_pds_wifi_diag_reason_name(uint32_t reason)
{
	switch (reason) {
	case QCC74X_PM_PDS15_WIFI_DIAG_REASON_WIFI_DISABLED:
		return "wifi_disabled";
	case QCC74X_PM_PDS15_WIFI_DIAG_REASON_NOT_CONNECTED:
		return "not_connected";
	case QCC74X_PM_PDS15_WIFI_DIAG_REASON_PS_NOT_COMPILED:
		return "ps_not_compiled";
	case QCC74X_PM_PDS15_WIFI_DIAG_REASON_ACTIVE_CHECK_NOT_RUN:
		return "active_check_not_run";
	case QCC74X_PM_PDS15_WIFI_DIAG_REASON_PS_SLEEP_CHECK_FAILED:
		return "ps_sleep_check_failed";
	case QCC74X_PM_PDS15_WIFI_DIAG_REASON_DTIM_WINDOW_BLOCKED:
		return "dtim_window_blocked";
	case QCC74X_PM_PDS15_WIFI_DIAG_REASON_TWT_TOO_CLOSE:
		return "twt_too_close";
	case QCC74X_PM_PDS15_WIFI_DIAG_REASON_READY:
		return "ready";
	case QCC74X_PM_PDS15_WIFI_DIAG_REASON_STA_BUSY:
		return "sta_busy";
	case QCC74X_PM_PDS15_WIFI_DIAG_REASON_NONE:
	default:
		return "none";
	}
}

static const char *lp_pds_auto_diag_reason_name(uint32_t reason)
{
	switch (reason) {
	case QCC74X_PM_PDS15_AUTO_DIAG_REASON_AUTO_DISABLED:
		return "auto_disabled";
	case QCC74X_PM_PDS15_AUTO_DIAG_REASON_NOT_INITIALIZED:
		return "not_initialized";
	case QCC74X_PM_PDS15_AUTO_DIAG_REASON_STATE_LOCKED:
		return "state_locked";
	case QCC74X_PM_PDS15_AUTO_DIAG_REASON_TIMEOUT_TOO_SHORT:
		return "timeout_too_short";
	case QCC74X_PM_PDS15_AUTO_DIAG_REASON_ENTER_BUSY:
		return "enter_busy";
	case QCC74X_PM_PDS15_AUTO_DIAG_REASON_RESUME_PENDING:
		return "resume_pending";
	case QCC74X_PM_PDS15_AUTO_DIAG_REASON_WIFI_NOT_READY:
		return "wifi_not_ready";
	case QCC74X_PM_PDS15_AUTO_DIAG_REASON_READY:
		return "ready";
	case QCC74X_PM_PDS15_AUTO_DIAG_REASON_NONE:
	default:
		return "none";
	}
}

static int lp_pds_parse_u32(const char *text, uint32_t *value)
{
	char *end = NULL;
	unsigned long parsed;

	if ((text == NULL) || (value == NULL)) {
		return -EINVAL;
	}

	errno = 0;
	parsed = strtoul(text, &end, 0);
	if ((errno != 0) || (end == text) || (*end != '\0') ||
	    (parsed > UINT32_MAX)) {
		return -EINVAL;
	}

	*value = (uint32_t)parsed;
	return 0;
}

static uint64_t lp_pds_auto_remaining_us(
	const struct qcc74x_pm_pds15_status *status)
{
	uint64_t now_us;

	if ((status == NULL) || !status->auto_deadline_active ||
	    (status->auto_deadline_us == 0U)) {
		return 0U;
	}

	now_us = qc7xx_lp_get_virtual_us();
	if (now_us >= status->auto_deadline_us) {
		return 0U;
	}

	return status->auto_deadline_us - now_us;
}

static void lp_pds_print_diag(const struct shell *sh,
			      const struct qcc74x_pm_diag_stats *diag)
{
	shell_print(sh,
		    "lp_pds diag: state_set=%u exit_post_ops=%u shallow=%u deep=%u prepare=%u skip=%u last_skip=%s resume_ok=%u resume_fail=%u last_rc=%d wake_reason=0x%08x requested_us=%llu elapsed_us=%llu",
		    diag->state_set_calls,
		    diag->exit_post_ops_calls,
		    diag->shallow_idle_calls,
		    diag->deep_sleep_calls,
		    diag->deep_prepare_calls,
		    diag->deep_skip_calls,
		    lp_pds_deep_skip_reason_name(
			    diag->last_deep_skip_reason),
		    diag->deep_resume_success,
		    diag->deep_resume_failures,
		    diag->last_deep_return_code,
		    diag->last_wake_reason,
		    (unsigned long long)diag->last_deep_requested_us,
		    (unsigned long long)diag->last_deep_elapsed_us);
	shell_print(
		sh,
		"lp_pds diag_skip: not_armed=%u enter_busy=%u deadline_reached=%u next_timeout_immediate=%u no_wake_source=%u wifi_blocked=%u ble_blocked=%u",
		diag->deep_skip_reason_counts
			[QCC74X_PM_DEEP_SKIP_REASON_NOT_ARMED],
		diag->deep_skip_reason_counts
			[QCC74X_PM_DEEP_SKIP_REASON_ENTER_BUSY],
		diag->deep_skip_reason_counts
			[QCC74X_PM_DEEP_SKIP_REASON_DEADLINE_REACHED],
		diag->deep_skip_reason_counts
			[QCC74X_PM_DEEP_SKIP_REASON_NEXT_TIMEOUT_IMMEDIATE],
		diag->deep_skip_reason_counts
			[QCC74X_PM_DEEP_SKIP_REASON_NO_WAKE_SOURCE],
		diag->deep_skip_reason_counts
			[QCC74X_PM_DEEP_SKIP_REASON_WIFI_BLOCKED],
		diag->deep_skip_reason_counts
			[QCC74X_PM_DEEP_SKIP_REASON_BLE_BLOCKED]);
}

static void lp_pds_print_power_stats(const struct shell *sh)
{
	qc7xx_lp_info_t info;
	struct qcc74x_pm_pds15_status status;
	uint64_t sleep_pct_x100;
	uint64_t lpfw_pct_x100;
	uint64_t app_pct_x100;

	memset(&status, 0, sizeof(status));
	qcc74x_pm_pds15_get_status(&status);
	if (!status.initialized) {
		shell_warn(sh, "lp_pds power: LPFW not initialized yet");
		return;
	}

	memset(&info, 0, sizeof(info));
	qc7xx_lp_info_get(&info);

	sleep_pct_x100 = lp_pds_ratio_pct_x100(info.sleep_pds_us,
					       info.time_total_us);
	lpfw_pct_x100 = lp_pds_ratio_pct_x100(info.active_lpfw_us,
					      info.time_total_us);
	app_pct_x100 = lp_pds_ratio_pct_x100(info.active_app_us,
					     info.time_total_us);

	shell_print(
		sh,
		"lp_pds power: total_us=%llu sleep_pds_us=%llu active_lpfw_us=%llu active_app_us=%llu sleep_pct=%llu.%02llu lpfw_pct=%llu.%02llu app_pct=%llu.%02llu lpfw_wakeup_cnt=%d recv_cnt=%u loss_cnt=%u",
		(unsigned long long)info.time_total_us,
		(unsigned long long)info.sleep_pds_us,
		(unsigned long long)info.active_lpfw_us,
		(unsigned long long)info.active_app_us,
		(unsigned long long)(sleep_pct_x100 / 100ULL),
		(unsigned long long)(sleep_pct_x100 % 100ULL),
		(unsigned long long)(lpfw_pct_x100 / 100ULL),
		(unsigned long long)(lpfw_pct_x100 % 100ULL),
		(unsigned long long)(app_pct_x100 / 100ULL),
		(unsigned long long)(app_pct_x100 % 100ULL),
		info.lpfw_wakeup_cnt, info.lpfw_recv_cnt, info.lpfw_loss_cnt);
	shell_print(
		sh,
		"lp_pds power_ms: total=%llu pds=%llu lpfw=%llu app=%llu",
		(unsigned long long)(info.time_total_us / USEC_PER_MSEC),
		(unsigned long long)(info.sleep_pds_us / USEC_PER_MSEC),
		(unsigned long long)(info.active_lpfw_us / USEC_PER_MSEC),
		(unsigned long long)(info.active_app_us / USEC_PER_MSEC));

	if (info.time_total_us == 0U) {
		shell_warn(
			sh,
			"lp_pds power: total_us is 0, run a low-power session first");
	}
}

static void lp_pds_print_wifi_diag(const struct shell *sh)
{
	struct qcc74x_pm_pds15_wifi_diag_status diag;

	qcc74x_pm_pds15_wifi_diag_get(&diag);

	shell_print(sh,
		    "lp_pds wifi: sampled=%d samples=%u active_checks=%u connected_samples=%u wifi_config=%d ps_compiled=%d active_check_ran=%d",
		    diag.sampled, diag.sample_count, diag.active_check_count,
		    diag.connected_count, diag.wifi_config_enabled,
		    diag.wifi_ps_compiled, diag.active_check_ran);
	shell_print(sh,
		    "lp_pds wifi_state: connected=%d raw_state=%d bssid=%02x:%02x:%02x:%02x:%02x:%02x bssid_rc=%d channel_rc=%d channel=%d aid=%d twt_flow=%d",
		    diag.sta_connected,
		    diag.sta_raw_state,
		    diag.bssid[0], diag.bssid[1], diag.bssid[2],
		    diag.bssid[3], diag.bssid[4], diag.bssid[5],
		    diag.bssid_rc, diag.channel_rc, diag.channel, diag.aid,
		    diag.twt_flow_count);
	shell_print(sh,
		    "lp_pds wifi_checks: ps_sleep_check=%d lpfw_check_allow=%d next_wakeup_us=%u next_valid=%d last_reason=%u(%s)",
		    diag.ps_sleep_check_rc, diag.lpfw_check_allow,
		    diag.next_wakeup_timer_us, diag.next_wakeup_timer_valid,
		    diag.last_reason,
		    lp_pds_wifi_diag_reason_name(diag.last_reason));
	shell_print(sh,
		    "lp_pds wifi_ps_detail: cpu=%d queue_sent_empty=%d queue_saved_empty=%d ps=%d tx=%d machw=%d",
		    diag.ps_cpu_can_sleep, diag.ps_queue_sent_empty,
		    diag.ps_queue_saved_empty, diag.ps_allowed,
		    diag.tx_allowed, diag.machw_allowed);

	for (uint32_t reason = 0U;
	     reason < QCC74X_PM_PDS15_WIFI_DIAG_REASON_COUNT; reason++) {
		if (diag.reason_counts[reason] == 0U) {
			continue;
		}
		shell_print(sh, "lp_pds wifi_reason[%u:%s]=%u",
			    reason, lp_pds_wifi_diag_reason_name(reason),
			    diag.reason_counts[reason]);
	}
}

static void lp_pds_print_auto_diag(const struct shell *sh)
{
	struct qcc74x_pm_pds15_auto_diag_status diag;
	uint32_t reason_count = 0U;

	qcc74x_pm_pds15_auto_diag_get(&diag);
	if (diag.last_reason < QCC74X_PM_PDS15_AUTO_DIAG_REASON_COUNT) {
		reason_count = diag.reason_counts[diag.last_reason];
	}

	shell_print(sh,
		    "lp_pds auto_diag: sampled=%d sample=%u ready=%u reason=%s reason_count=%u ticks=%d min_ticks=%u timeout_us=%llu state_available=%d deadline_active=%d deadline_expired=%d remaining_us=%llu",
		    diag.sampled,
		    diag.sample_count,
		    diag.ready_count,
		    lp_pds_auto_diag_reason_name(diag.last_reason),
		    reason_count,
		    diag.ticks,
		    diag.min_residency_ticks,
		    (unsigned long long)diag.timeout_us,
		    diag.state_available,
		    diag.auto_deadline_active,
		    diag.auto_deadline_expired,
		    (unsigned long long)diag.auto_remaining_us);
	shell_print(sh,
		    "lp_pds auto_diag_state: config=%d enabled=%d policy_lock=%d initialized=%d enter_busy=%d resume_pending=%d wifi_reason=%s",
		    diag.auto_config_enabled,
		    diag.auto_enabled,
		    diag.policy_lock_active,
		    diag.initialized,
		    diag.enter_busy,
		    diag.resume_pending,
		    lp_pds_wifi_diag_reason_name(diag.wifi_reason));
}

static void lp_pds_print_status(const struct shell *sh)
{
	struct qcc74x_pm_pds15_status status;
	struct qcc74x_pm_diag_stats diag;
	uint32_t deep_sleep_cycles;
	uint32_t deep_sleep_ms;

	qcc74x_pm_pds15_get_status(&status);
	qcc74x_pm_diag_get(&diag);
	deep_sleep_ms = (uint32_t)(status.timeout_us / USEC_PER_MSEC);
	deep_sleep_cycles = status.cycle_count;

	shell_print(sh,
		    "lp_pds config: lowpower=1 diag=%d pds15=%d system_device_pm=%d psram=%d",
		    IS_ENABLED(CONFIG_QCC74X_PM_DIAGNOSTICS),
		    IS_ENABLED(CONFIG_QCC74X_PM_PDS15),
		    IS_ENABLED(CONFIG_PM_DEVICE_SYSTEM_MANAGED),
		    IS_ENABLED(CONFIG_PSRAM));
	shell_print(sh,
		    "lp_pds state: initialized=%d init_in_progress=%d init_rc=%d policy_lock=%d current_slice_us=%llu",
		    status.initialized,
		    status.init_in_progress,
		    status.init_rc,
		    qcc74x_pm_pds15_policy_lock_is_active(),
		    (unsigned long long)status.timeout_us);
	shell_print(sh,
		    "lp_pds auto: config=%d enabled=%d policy_lock=%d pending=%d timeout_us=%llu deadline_active=%d remaining_us=%llu",
		    IS_ENABLED(CONFIG_QCC74X_PM_PDS15_POLICY),
		    status.auto_enabled,
		    status.policy_lock_active,
		    status.auto_entry_pending,
		    (unsigned long long)status.auto_timeout_us,
		    status.auto_deadline_active,
		    (unsigned long long)lp_pds_auto_remaining_us(&status));
	shell_print(sh,
		    "lp_pds deep_sleep: sleep_ms=%u cycles=%u",
		    deep_sleep_ms, deep_sleep_cycles);
	lp_pds_print_power_stats(sh);
	lp_pds_print_diag(sh, &diag);
	qcc74x_pm_pds15_auto_diag_sample();
	lp_pds_print_auto_diag(sh);
	lp_pds_print_wifi_diag(sh);
}

static int cmd_lp_pds_show(const struct shell *sh, size_t argc, char *argv[])
{
	ARG_UNUSED(argc);
	ARG_UNUSED(argv);

	lp_pds_print_status(sh);

	return 0;
}

static int cmd_lp_pds_auto(const struct shell *sh, size_t argc, char *argv[])
{
	struct qcc74x_pm_pds15_status status;
	uint32_t duration_ms = 0U;
	bool enable;
	bool release_pending = false;
	int rc;

	if ((argc < 2U) || (argc > 3U)) {
		shell_error(sh,
			    "lp_pds auto: usage lp_pds auto <on [duration_ms]|off|show>");
		return -EINVAL;
	}

	if (strcmp(argv[1], "show") == 0) {
		if (argc != 2U) {
			shell_error(sh,
				    "lp_pds auto: usage lp_pds auto show");
			return -EINVAL;
		}
		qcc74x_pm_pds15_get_status(&status);
		qcc74x_pm_pds15_auto_diag_sample();
		shell_print(sh,
			    "lp_pds auto: config=%d enabled=%d policy_lock=%d initialized=%d init_rc=%d pending=%d timeout_us=%llu deadline_active=%d deadline_us=%llu remaining_us=%llu",
			    IS_ENABLED(CONFIG_QCC74X_PM_PDS15_POLICY),
			    status.auto_enabled,
			    status.policy_lock_active,
			    status.initialized,
			    status.init_rc,
			    status.auto_entry_pending,
			    (unsigned long long)status.auto_timeout_us,
			    status.auto_deadline_active,
			    (unsigned long long)status.auto_deadline_us,
			    (unsigned long long)lp_pds_auto_remaining_us(
				    &status));
		lp_pds_print_auto_diag(sh);
		return 0;
	}

	if (strcmp(argv[1], "on") == 0) {
		enable = true;
		if ((argc == 3U) &&
		    (lp_pds_parse_u32(argv[2], &duration_ms) != 0)) {
			shell_error(sh, "lp_pds auto: invalid duration_ms '%s'",
				    argv[2]);
			return -EINVAL;
		}
	} else if (strcmp(argv[1], "off") == 0) {
		if (argc != 2U) {
			shell_error(sh,
				    "lp_pds auto: usage lp_pds auto off");
			return -EINVAL;
		}
		enable = false;
	} else {
		shell_error(sh,
			    "lp_pds auto: usage lp_pds auto <on [duration_ms]|off|show>");
		return -EINVAL;
	}
	if (enable && (duration_ms != 0U)) {
		rc = qcc74x_pm_pds15_auto_arm_for(
			lp_pds_ms_to_us(duration_ms), &release_pending);
	} else {
		rc = qcc74x_pm_pds15_auto_enable(enable);
	}
	if (rc != 0) {
		shell_error(sh, "lp_pds auto: %s failed rc=%d",
			    enable ? "on" : "off", rc);
		return rc;
	}

	qcc74x_pm_pds15_get_status(&status);
	shell_print(sh,
		    "lp_pds auto: %s enabled=%d policy_lock=%d duration_ms=%u remaining_us=%llu",
		    enable ? "on" : "off", status.auto_enabled,
		    status.policy_lock_active,
		    status.auto_deadline_active ? duration_ms : 0U,
		    (unsigned long long)lp_pds_auto_remaining_us(&status));

	if (release_pending) {
		qcc74x_pm_pds15_auto_release_pending_lock();
	}

	return 0;
}

static int cmd_lp_pds_reset(const struct shell *sh, size_t argc, char *argv[])
{
	ARG_UNUSED(argc);
	ARG_UNUSED(argv);

	(void)qcc74x_pm_pds15_auto_enable(false);
	(void)qcc74x_pm_pds15_policy_lock_set(true);
	qcc74x_pm_diag_reset();
	qcc74x_pm_pds15_wifi_diag_reset();
	qcc74x_pm_pds15_auto_diag_reset();
	qc7xx_lp_info_clear();

	shell_print(sh,
		    "lp_pds: disabled auto low power, locked PDS15, reset diagnostics, and cleared LP power stats");

	return 0;
}

static int cmd_lp_pds_wifi_show(const struct shell *sh, size_t argc,
				char *argv[])
{
	ARG_UNUSED(argc);
	ARG_UNUSED(argv);

	lp_pds_print_wifi_diag(sh);

	return 0;
}

#if defined(CONFIG_QCC74X_PM_PDS15_BLE)
static int cmd_lp_pds_ble_show(const struct shell *sh, size_t argc,
			       char *argv[])
{
	struct qcc74x_pm_pds15_ble_diag_status status;

	ARG_UNUSED(argc);
	ARG_UNUSED(argv);

	qcc74x_pm_pds15_ble_diag_get(&status);
	shell_print(sh,
		    "lp_pds ble: sampled=%d bt_ready=%d sample=%u allowed=%u capped=%u blocked=%u crash_recovery=%u last_sleep_rtc=%d last_capped_us=%llu last_crash_elapsed_us=%llu last_crash_expected_us=%llu",
		    status.sampled, status.bt_ready,
		    status.sample_count, status.allowed_count,
		    status.capped_count, status.blocked_count,
		    status.crash_recovery_count,
		    status.last_sleep_rtc,
		    (unsigned long long)status.last_capped_us,
		    (unsigned long long)status.last_crash_elapsed_us,
		    (unsigned long long)status.last_crash_expected_us);
	return 0;
}

static int cmd_lp_pds_ble_reset(const struct shell *sh, size_t argc,
				char *argv[])
{
	ARG_UNUSED(argc);
	ARG_UNUSED(argv);
	qcc74x_pm_pds15_ble_diag_reset();
	shell_print(sh, "lp_pds ble: diagnostics reset");
	return 0;
}

static int cmd_lp_pds_ble_inject_crash(const struct shell *sh, size_t argc,
				       char *argv[])
{
	ARG_UNUSED(argc);
	ARG_UNUSED(argv);
	qcc74x_pm_pds15_ble_inject_crash();
	shell_print(sh,
		    "lp_pds ble: next PDS15 wake will exercise BLE crash recovery");
	return 0;
}

SHELL_STATIC_SUBCMD_SET_CREATE(
	sub_lp_pds_ble,
	SHELL_CMD_ARG(show, NULL, "Show BLE PDS15 diagnostic counters",
		      cmd_lp_pds_ble_show, 1, 0),
	SHELL_CMD_ARG(reset, NULL, "Reset BLE PDS15 diagnostic counters",
		      cmd_lp_pds_ble_reset, 1, 0),
	SHELL_CMD_ARG(inject_crash, NULL,
		      "Force next PDS15 wake into BLE crash recovery path",
		      cmd_lp_pds_ble_inject_crash, 1, 0),
	SHELL_SUBCMD_SET_END);
#endif /* CONFIG_QCC74X_PM_PDS15_BLE */

SHELL_STATIC_SUBCMD_SET_CREATE(
	sub_lp_pds_wifi,
	SHELL_CMD_ARG(show, NULL, "Show last Wi-Fi PDS15 diagnostic sample",
		      cmd_lp_pds_wifi_show, 1, 0),
	SHELL_SUBCMD_SET_END);

SHELL_STATIC_SUBCMD_SET_CREATE(
	sub_lp_pds,
	SHELL_CMD_ARG(show, NULL, "Show low-power LPFW init and PDS15 status",
		      cmd_lp_pds_show, 1, 0),
	SHELL_CMD_ARG(auto, NULL,
		      "Control automatic PDS15 policy gate. Usage: lp_pds auto <on [duration_ms]|off|show>",
		      cmd_lp_pds_auto, 2, 1),
	SHELL_CMD(wifi, &sub_lp_pds_wifi, "Show Wi-Fi PDS15 diagnostics",
		  NULL),
#if defined(CONFIG_QCC74X_PM_PDS15_BLE)
	SHELL_CMD(ble, &sub_lp_pds_ble,
		  "Show/reset BLE PDS15 diagnostics or inject crash test",
		  NULL),
#endif
	SHELL_CMD_ARG(reset, NULL,
		      "Cancel any pending arm and reset low-power diagnostics",
		      cmd_lp_pds_reset, 1, 0),
	SHELL_SUBCMD_SET_END);

SHELL_SUBCMD_ADD((qcom), pm, &sub_lp_pds, "low-power commands", NULL, 1, 0);

#endif /* CONFIG_WIFI_SHELL_LOWPOWER_VALIDATION */
```

## src/qcc74x_coex_shell.c
```c
/*
 * Copyright (c) 2026 Qualcomm Technologies, Inc. and/or its subsidiaries
 * SPDX-License-Identifier: BSD-3-Clause
 */

#include <errno.h>
#include <stdint.h>
#include <stdlib.h>

#include <zephyr/kernel.h>
#include <zephyr/shell/shell.h>
#include <zephyr/bluetooth/bluetooth.h>
#include <zephyr/sys/atomic.h>

#include <zephyr/kernel.h>
#include <zephyr/version.h>
#include <zephyr/sys/util.h>
#include <zephyr/drivers/uart.h>

#include "wifi_mgmr_ext.h"

#if defined(CONFIG_BT_OBSERVER)
#define COEX_SCAN_MAX_UNIQUE 64

static atomic_t coex_scan_packets;
static atomic_t coex_scan_unique;
static atomic_t coex_scan_last_ms;
static bt_addr_le_t coex_scan_addresses[COEX_SCAN_MAX_UNIQUE];
static int coex_scan_previous_packets;
static int coex_scan_sequence;
static K_MUTEX_DEFINE(coex_scan_stats_lock);

static void coex_scan_recv(const struct bt_le_scan_recv_info *info,
			   struct net_buf_simple *buf)
{
	ARG_UNUSED(buf);
	unsigned int key = irq_lock();
	bool known = false;
	int unique = atomic_get(&coex_scan_unique);

	for (int i = 0; i < unique; i++) {
		if (bt_addr_le_cmp(&coex_scan_addresses[i], info->addr) == 0) {
			known = true;
			break;
		}
	}
	if (!known && unique < COEX_SCAN_MAX_UNIQUE) {
		bt_addr_le_copy(&coex_scan_addresses[unique], info->addr);
		atomic_set(&coex_scan_unique, unique + 1);
	}
	atomic_inc(&coex_scan_packets);
	atomic_set(&coex_scan_last_ms, (atomic_val_t)k_uptime_get_32());
	irq_unlock(key);
}

static struct bt_le_scan_cb coex_scan_cb = {
	.recv = coex_scan_recv,
};

/*
 * Scan counters are reported only when explicitly queried.  An unsolicited
 * periodic print would share the console with the shell and could land in the
 * middle of a command being typed, splitting its echo and corrupting the
 * transaction the host is waiting on.
 */
static void coex_scan_stats_report(const struct shell *sh)
{
	uint32_t now = k_uptime_get_32();
	uint32_t last = (uint32_t)atomic_get(&coex_scan_last_ms);
	int packets = atomic_get(&coex_scan_packets);
	int unique = atomic_get(&coex_scan_unique);

	shell_print(sh, "COEX_BLE_SCAN_STATS seq=%d packets=%d unique=%d "
		    "interval_packets=%d last_ms=%u",
		    ++coex_scan_sequence, packets, unique,
		    packets - coex_scan_previous_packets,
		    (uint32_t)(now - last));
	coex_scan_previous_packets = packets;
}

static int coex_scan_stats_init(void)
{
	#if defined(CONFIG_WIFI_SHELL_COEX_VALIDATION)
	char identity[320];
	const struct device *console = DEVICE_DT_GET(DT_CHOSEN(zephyr_console));
	int length = snprintk(identity, sizeof(identity),
	       "\r\nCOEX_FW identity=wifi-shell-coex protocol=1 build=%s "
	       "central=%d observer=%d gatt_client=%d bt_shell=%d max_conn=%d "
	       "coex=%d low_power=%d END\r\n",
	       STRINGIFY(BUILD_VERSION), IS_ENABLED(CONFIG_BT_CENTRAL),
	       IS_ENABLED(CONFIG_BT_OBSERVER), IS_ENABLED(CONFIG_BT_GATT_CLIENT),
	       IS_ENABLED(CONFIG_BT_SHELL), COND_CODE_1(CONFIG_BT, (CONFIG_BT_MAX_CONN), (0)),
	       IS_ENABLED(CONFIG_QCC74X_WIFI_COEX), IS_ENABLED(CONFIG_QCC74X_WIFI_LOW_POWER));
	/* Identity must not depend on printk's log-backend filtering/routing. */
	if (device_is_ready(console) && length > 0 && length < sizeof(identity)) {
		for (int i = 0; i < length; i++) {
			uart_poll_out(console, identity[i]);
		}
	}
#endif
	return bt_le_scan_cb_register(&coex_scan_cb);
}

SYS_INIT(coex_scan_stats_init, APPLICATION, CONFIG_APPLICATION_INIT_PRIORITY);
#endif

static int cmd_coex_enable(const struct shell *sh, size_t argc, char **argv)
{
	ARG_UNUSED(argc);
	ARG_UNUSED(argv);

	int rc = wifi_mgmr_sta_coex_enable();

	shell_print(sh, "qcc74x_coex enable: rc=%d", rc);
	return rc;
}

static int cmd_coex_disable(const struct shell *sh, size_t argc, char **argv)
{
	ARG_UNUSED(argc);
	ARG_UNUSED(argv);

	int rc = wifi_mgmr_sta_coex_disable();

	shell_print(sh, "qcc74x_coex disable: rc=%d", rc);
	return rc;
}

static int cmd_coex_status(const struct shell *sh, size_t argc, char **argv)
{
	ARG_UNUSED(argc);
	ARG_UNUSED(argv);

	int status = wifi_mgmr_sta_coex_status_get();
	int duty_ms = wifi_mgmr_sta_coex_duty_get();

	shell_print(sh, "qcc74x_coex: status=%d duty_ms=%d", status, duty_ms);
	return status < 0 ? status : 0;
}

static int cmd_coex_duty(const struct shell *sh, size_t argc, char **argv)
{
	if (argc == 1) {
		int duty_ms = wifi_mgmr_sta_coex_duty_get();

		shell_print(sh, "qcc74x_coex duty: %d ms", duty_ms);
		return duty_ms < 0 ? duty_ms : 0;
	}

	char *endptr;
	long duty_ms = strtol(argv[1], &endptr, 0);

	if (*endptr != '\0' || duty_ms < 10 || duty_ms > 90) {
		shell_error(sh, "duty range: 10..90 ms");
		return -EINVAL;
	}

	int rc = wifi_mgmr_sta_coex_duty_set((uint8_t)duty_ms);

	shell_print(sh, "qcc74x_coex duty set: %ld ms rc=%d", duty_ms, rc);
	return rc;
}

#if defined(CONFIG_BT_OBSERVER)
static int cmd_coex_scanstats(const struct shell *sh, size_t argc, char **argv)
{
	ARG_UNUSED(argc);
	ARG_UNUSED(argv);

	k_mutex_lock(&coex_scan_stats_lock, K_FOREVER);
	coex_scan_stats_report(sh);
	k_mutex_unlock(&coex_scan_stats_lock);
	return 0;
}
#endif

SHELL_STATIC_SUBCMD_SET_CREATE(qcc74x_coex_cmds,
	SHELL_CMD_ARG(enable, NULL, NULL, cmd_coex_enable, 1, 0),
	SHELL_CMD_ARG(disable, NULL, NULL, cmd_coex_disable, 1, 0),
	SHELL_CMD_ARG(status, NULL, NULL, cmd_coex_status, 1, 0),
	SHELL_CMD_ARG(duty, NULL, NULL, cmd_coex_duty, 1, 1),
#if defined(CONFIG_BT_OBSERVER)
	SHELL_CMD_ARG(scanstats, NULL, "Report BLE scan counters", cmd_coex_scanstats, 1, 0),
#endif
	SHELL_SUBCMD_SET_END
);

SHELL_SUBCMD_ADD((qcom), coex, &qcc74x_coex_cmds, "coex commands", NULL, 1, 0);
```
