## qcc74x_testing/samples/net/wifi/shell/boards/qcc748m_evk.conf
```kconfig
# ==================== Shell Configuration ====================
# Stack size for shell task
CONFIG_SHELL_STACK_SIZE=3072
# Reopen / startup on this bench can deliver a short RX burst before the shell
# thread drains input, so keep more headroom than the generic default (64).
CONFIG_SHELL_BACKEND_SERIAL_RX_RING_BUFFER_SIZE=128
# Shell prompt setting
CONFIG_SHELL_PROMPT_UART="qcc74x:~$"
#not defined yet
#CONFIG_ETH_QC7XX_EMAC=n

# ==================== Network Buffers & Interfaces ====================
# Number of RX packets
CONFIG_NET_PKT_RX_COUNT=8
# Number of TX packets
CONFIG_NET_PKT_TX_COUNT=14
# Network buffer pool size (RX)
CONFIG_NET_BUF_RX_COUNT=8
# Network buffer pool size (TX)
CONFIG_NET_BUF_TX_COUNT=16
# Max IPv4 addresses per interface
CONFIG_NET_IF_MAX_IPV4_COUNT=2
# Max IPv6 addresses per interface
CONFIG_NET_IF_MAX_IPV6_COUNT=2
# Enable Ethernet L2
CONFIG_NET_L2_ETHERNET=y
CONFIG_NET_BUF_DATA_SIZE=1600
CONFIG_NET_BUF_POOL_USAGE=y
CONFIG_NET_BUF_LOG=y

CONFIG_NET_TX_STACK_SIZE=4096
CONFIG_NET_RX_STACK_SIZE=4096

CONFIG_NET_TCP_WORKQ_STACK_SIZE=2048
# ==================== Network Management ====================
# Net management event queue size
CONFIG_NET_MGMT_EVENT_QUEUE_SIZE=10
# Net management event handler stack size
CONFIG_NET_MGMT_EVENT_STACK_SIZE=8192
# Enable network connection manager
CONFIG_NET_CONNECTION_MANAGER=y
CONFIG_NET_CONNECTION_MANAGER_MONITOR_STACK_SIZE=2048

# ==================== Ethernet Driver ====================
# Keep the WiFi shell sample off the EMAC path for now.
# CONFIG_ETH_DRIVER is not set
# CONFIG_ETH_PHY_DRIVER is not set

# ==================== IPv4 & DHCPv4 ====================
# Number of DHCPv4 server addresses
CONFIG_NET_DHCPV4_SERVER_ADDR_COUNT=4
# ICMP probe timeout for DHCPv4 (ms)
CONFIG_NET_DHCPV4_SERVER_ICMP_PROBE_TIMEOUT=1000
# Enable DHCPv4 server
CONFIG_NET_DHCPV4_SERVER=y
# Enable DHCPv4 DNS address option
CONFIG_NET_DHCPV4_OPTION_DNS_ADDRESS=y
# DHCPv4 server log level: debug
CONFIG_NET_DHCPV4_SERVER_LOG_LEVEL_DBG=y

# ==================== IPv6 & DHCPv6 ====================
# Enable IPv6 protocol
CONFIG_NET_IPV6=y
# Enable RDNSS option in IPv6 RA
CONFIG_NET_IPV6_RA_RDNSS=y
# Enable DHCPv6 DNS address option
CONFIG_NET_DHCPV6_OPTION_DNS_ADDRESS=y

# ==================== Sockets & TLS/DTLS ====================
# Keep the sample on the plain sockets path on Zephyr 4.3.
# CONFIG_NET_SOCKETS_SOCKOPT_TLS is not set
# CONFIG_NET_SOCKETS_ENABLE_DTLS is not set
# DNS query timeout (ms)
CONFIG_NET_SOCKETS_DNS_TIMEOUT=2000
# DNS backoff interval (ms)
CONFIG_NET_SOCKETS_DNS_BACKOFF_INTERVAL=5000
# Enable Sockets service
CONFIG_NET_SOCKETS_SERVICE=y
# Service thread priority
CONFIG_NET_SOCKETS_SERVICE_THREAD_PRIO=15
# Service thread stack size
CONFIG_NET_SOCKETS_SERVICE_STACK_SIZE=4096

# ==================== DNS Resolver ====================
CONFIG_DNS_RESOLVER=y

# ==================== Network Test Tool ====================
# Enable zperf performance testing
CONFIG_NET_ZPERF=y
CONFIG_NET_ZPERF_SERVER=y
CONFIG_NET_ZPERF_MAX_SESSIONS=6
CONFIG_ZPERF_SESSION_PER_THREAD=y
CONFIG_ZPERF_WORK_Q_STACK_SIZE=4096
CONFIG_NET_ZPERF_MAX_PACKET_SIZE=1500

# ==================== Statistics ====================
# Enable named statistics
CONFIG_STATS_NAMES=y
# Enable stats in shell
CONFIG_STATS_SHELL=y
# Enable statistics
CONFIG_STATS=y
# Enable network statistics shell commands
CONFIG_NET_STATISTICS_USER_API=y

# ==================== WiFi Configuration ====================
# QCC74X WiFi driver
CONFIG_WIFI_QCC74X=y
# AP & STA mode support
CONFIG_QC7XX_WIFI_AP_STA_MODE=y
# STA mode auto DHCPv4
CONFIG_QC7XX_WIFI_STA_AUTO_DHCPV4=y
# WiFi network manager
CONFIG_WIFI_NM=y
# Max managed interfaces
CONFIG_WIFI_NM_MAX_MANAGED_INTERFACES=4
# Shell max AP/STA interfaces
CONFIG_WIFI_SHELL_MAX_AP_STA=4

# ==================== Threads & Workqueue ====================
# Main stack size
CONFIG_MAIN_STACK_SIZE=4096
# System workqueue stack size
CONFIG_SYSTEM_WORKQUEUE_STACK_SIZE=6144
# Dynamic threads support
CONFIG_DYNAMIC_THREAD=y
CONFIG_DYNAMIC_THREAD_ALLOC=y
CONFIG_DYNAMIC_THREAD_PREFER_POOL=y
# Runtime statistics
CONFIG_THREAD_RUNTIME_STATS=y
CONFIG_THREAD_RUNTIME_STATS_USE_TIMING_FUNCTIONS=y
# Thread info & monitoring
CONFIG_THREAD_STACK_INFO=y
CONFIG_THREAD_MONITOR=y
CONFIG_THREAD_NAME=y
CONFIG_THREAD_CUSTOM_DATA=y
# Initialize all thread stacks
CONFIG_INIT_STACKS=y

# ==================== Memory & Heap ====================
# Heap memory pool size
CONFIG_HEAP_MEM_POOL_SIZE=32708
# Sys heap runtime stats
CONFIG_SYS_HEAP_RUNTIME_STATS=y
# Shared multi-heap support
CONFIG_SHARED_MULTI_HEAP=y
# ==================== mbedTLS / PSA Crypto ====================
# Zephyr 4.3 moved most legacy mbedTLS feature toggles behind PSA wants.
# Keep TLS sockets disabled above, but still link the crypto pieces used
# by the QC7XX wireless HAL blob.
CONFIG_MBEDTLS=y
# Use QCC74x soc_multi_heap via mbedtls_platform_set_calloc_free().
# CONFIG_MBEDTLS_ENABLE_HEAP is not set
CONFIG_MBEDTLS_PSA_STATIC_KEY_SLOTS=n
CONFIG_PSA_CRYPTO=y
CONFIG_PSA_CRYPTO_PROVIDER_MBEDTLS=y
CONFIG_PSA_CRYPTO_ENABLE_ALL=y
CONFIG_MBEDTLS_MD_C=y
CONFIG_MBEDTLS_ENTROPY_C=y
CONFIG_MBEDTLS_CTR_DRBG_C=y
CONFIG_MBEDTLS_PSA_CRYPTO_LEGACY_RNG=y
CONFIG_MBEDTLS_PK_WRITE_C=y
CONFIG_MBEDTLS_PKCS5_C=y
CONFIG_MBEDTLS_PEM_PARSE_C=y
CONFIG_MBEDTLS_ECP_NIST_OPTIM=y
CONFIG_MBEDTLS_AES_ROM_TABLES=y

# ==================== CRC & File System ====================
CONFIG_CRC=y
CONFIG_ZVFS_POLL_MAX=15

# ==================== Logging & Commands ====================
CONFIG_LOG=y
# Enable log commands
CONFIG_LOG_CMDS=y
CONFIG_NET_LOG=y

CONFIG_NET_CONFIG_LOG_LEVEL_DBG=y

# ==================== Core Dump & Debug ====================
CONFIG_DEBUG_COREDUMP=y
CONFIG_DEBUG_COREDUMP_BACKEND_LOGGING=y
CONFIG_DEBUG_COREDUMP_MEMORY_DUMP_MIN=y
CONFIG_DEBUG_COREDUMP_SHELL=y
CONFIG_SYMTAB=y
CONFIG_SYMTAB_SHELL=y
CONFIG_TRACING=y
CONFIG_DEBUG_THREAD_INFO=n
CONFIG_THREAD_ANALYZER=y
CONFIG_COREDUMP_DEVICE=y

# ==================== POSIX Support ====================
CONFIG_POSIX_API=y
CONFIG_POSIX_TIMERS=y
CONFIG_REQUIRES_FLOAT_PRINTF=y
CONFIG_PICOLIBC_IO_FLOAT=y

# ==================== Miscellaneous ====================
# Reboot support
CONFIG_REBOOT=y
```

## qcc74x_testing/samples/psa/testcase.yaml
```yaml
# Copyright (c) Qualcomm Technologies, Inc. and/or its subsidiaries.
# SPDX-License-Identifier: BSD-3-Clause

tests:
  crypto.psa_hash_qcc74x:
    tags: crypto psa hash
    depends_on: crypto
    platform_allow:
      - qcc748m_evk
```

## qcc74x_testing/tests/drivers/clock_control/clock_control_api/testcase.yaml
```yaml
common:
  tags:
    - drivers
    - clock_control

tests:
  qcc7xx.drivers.clock.clock_control_api:
    platform_allow:
      - qcc748m_evk
    timeout: 120
```

## qcc74x_testing/tests/drivers/comparator/gpio_loopback/testcase.yaml
```yaml
tests:
  qcc7xx.drivers.comparator.gpio_loopback:
    tags:
      - drivers
      - comparator
    depends_on:
      - comparator
      - gpio
    platform_allow:
      - qcc748m_evk
    timeout: 60
```

## qcc74x_testing/tests/drivers/comparator/pytest_shell/testcase.yaml
```yaml
tests:
  qcc7xx.drivers.comparator.pytest_shell:
    harness: pytest
    tags:
      - comparator
      - pytest
      - shell
      - qcc74x
    depends_on:
      - comparator
      - gpio
      - serial
    platform_allow:
      - qcc748m_evk
    timeout: 180
    harness_config:
      pytest_dut_scope: session
```

## qcc74x_testing/tests/drivers/comparator/ztress/testcase.yaml
```yaml
tests:
  qcc7xx.drivers.comparator.ztress:
    tags:
      - drivers
      - comparator
      - ztress
    depends_on:
      - comparator
      - gpio
    platform_allow:
      - qcc748m_evk
    timeout: 120
```
