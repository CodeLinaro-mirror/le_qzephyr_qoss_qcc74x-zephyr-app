## common/coredump/Kconfig
```kconfig
# Copyright (c) Qualcomm Technologies, Inc. and/or its subsidiaries
# SPDX-License-Identifier: BSD-3-Clause

menu "QCC74x Coredump Runtime"

config QCC74X_COREDUMP_RUNTIME
	bool "Enable QCC74x coredump runtime integration"
	depends on SOC_SERIES_QCC74X && DEBUG_COREDUMP
	help
	  Adds QCC74x fatal-path handling around Zephyr coredump generation.
	  The runtime protects full-memory Flash dumps with a pre-write budget
	  check, coordinates an enabled watchdog before capture, and emits
	  serial completion and coverage markers for logging backends.

config QCC74X_COREDUMP_AUTO_RESET
	bool "Cold-reset after coredump capture"
	depends on QCC74X_COREDUMP_RUNTIME
	default y
	help
	  Cold-reset the QCC74x SoC after a coredump completes or is rejected
	  before capture. For logging backends, the runtime first waits for the
	  console UART transmit FIFO and line state to become idle. Disable this
	  only when intentionally keeping a faulted target halted for debugger
	  post-mortem inspection.

if DEBUG_COREDUMP_BACKEND_OTHER

choice QCC74X_COREDUMP_OTHER_TRANSPORT
	prompt "QCC74x custom coredump transport"
	default QCC74X_COREDUMP_OTHER_SAFE_SERIAL

config QCC74X_COREDUMP_OTHER_SAFE_SERIAL
	bool "Use bounded raw UART output"
	help
	  Send QCC74x coredump records directly to the selected console UART TX
	  FIFO. The path does not use the logging subsystem, shell transport,
	  UART driver locks, interrupts, DMA, or runtime power management.

config QCC74X_COREDUMP_OTHER_SAFE_FLASH
	bool "Use emergency Flash partition output"
	depends on FLASH && QCC74X_COREDUMP_FULL_MEMORY
	help
	  Store the coredump in the fixed coredump partition using the QCC74x
	  nonblocking emergency Flash session. The crash path erases only that
	  partition and never waits on the normal Flash driver semaphore.

endchoice

config QCC74X_COREDUMP_OTHER_UART_POLL_LIMIT
	int "Maximum FIFO polls per panic UART byte"
	default 200000
	range 1 10000000
	depends on QCC74X_COREDUMP_OTHER_SAFE_SERIAL
	help
	  Bound the number of direct FIFO-ready register polls for each coredump
	  output byte. A timeout aborts the coredump transport rather than waiting
	  indefinitely in a fatal context.

endif # DEBUG_COREDUMP_BACKEND_OTHER

config QCC74X_COREDUMP_WATCHDOG_COORDINATION
	bool "Pause watchdog before coredump capture"
	depends on QCC74X_COREDUMP_RUNTIME && WATCHDOG && WDT_QCC74X
	default y
	help
	  Stops watchdog0 before coredump capture. This prevents watchdog reset
	  from truncating a long serial full-PSRAM dump. The application remains
	  responsible for its normal watchdog feeding policy.

config QCC74X_COREDUMP_SHELL
	bool "Enable QCC74x coredump status shell commands"
	depends on QCC74X_COREDUMP_RUNTIME && SHELL
	default y
	help
	  Adds safe runtime inspection commands under "qcom coredump". The
	  commands report backend, RAM coverage, PSRAM ledger state, and Flash
	  budget. Fault injection commands are intentionally not included.

config QCC74X_COREDUMP_TEST_COMMANDS
	bool "Enable destructive QCC74x coredump test commands"
	depends on QCC74X_COREDUMP_SHELL
	default n
	help
	  Add the "qcom coredump panic", "qcom coredump ebreak", and
	  "qcom coredump illegal" commands.
	  These commands deliberately stop normal execution and are intended only
	  for controlled coredump validation. The QCC748M illegal-instruction
	  probe is diagnostic only: it is not a validated Zephyr coredump path.

endmenu
```

## common/fota/Kconfig
```kconfig
config QCC74X_TCP_OTA
	bool "QCC74x raw TCP OTA"
	depends on NETWORKING && NET_TCP && SHELL && MBEDTLS
	help
	  Download a QCC74X RAW .ota image, verify it, stage it in the inactive
	  SBL partition, then explicitly activate it.

config QCC74X_TCP_OTA_SHELL
	bool "QCC74x TCP OTA shell commands"
	depends on QCC74X_TCP_OTA
	default y
	help
	  Enable the ota tcp start command and transport-neutral ota status,
	  ota cancel, ota slot, and ota activate commands.
```

## common/shell/Kconfig
```kconfig
# Copyright (c) Qualcomm Technologies, Inc. and/or its subsidiaries.
# SPDX-License-Identifier: BSD-3-Clause

menu "QCOM Platform Shell Modules"

config QCOM_SPI_SHELL
	bool "QCOM SPI shell"
	depends on SHELL && SPI
	help
	  Provides the qcom spi shell commands for configuring and exercising
	  the SPI controller as master or slave.

config QCOM_SHELL_ASYNC
	bool "Async shell command execution (dynamic thread pool)"
	depends on SHELL && DYNAMIC_THREAD && DYNAMIC_THREAD_ALLOC
	help
	  Provides shell_async_submit() to run shell command handlers in
	  dynamically allocated background threads.  Each submit() allocates
	  a stack from the system heap; the memory is freed when the next job
	  is submitted to the same slot (lazy reclaim via k_thread_join +
	  k_thread_stack_free).  No pre-created threads — idle cost is zero.

config SHELL_ASYNC_WORKERS
	int "Number of background worker threads"
	depends on QCOM_SHELL_ASYNC
	default 4
	range 1 8
	help
	  Each worker has its own dedicated stack (statically allocated).
	  A submitted job is assigned to the first free worker.

config SHELL_ASYNC_STACK_SIZE
	int "Per-worker stack size (bytes)"
	depends on QCOM_SHELL_ASYNC
	default 2048

config SHELL_ASYNC_PRIORITY
	int "Worker thread priority"
	depends on QCOM_SHELL_ASYNC
	default 5

config QCOM_I2C_EEPROM_SHELL
	bool "QCOM I2C EEPROM async test shell"
	depends on QCOM_SHELL_ASYNC && I2C
	help
	  Concurrent I2C EEPROM read/write tests via shell_async worker threads.
	  Target: GT24C02B (or compatible AT24Cxx) EEPROM at configurable address.
	    eeprom_test write   - write test pattern (background)
	    eeprom_test read    - read back and verify (background)
	    eeprom_test stress  - writer + reader concurrently
	    eeprom_test erase   - fill test area with 0xFF

config QCOM_I2C_SHELL
	bool "QCOM async I2C shell (replaces built-in CONFIG_I2C_SHELL)"
	depends on QCOM_SHELL_ASYNC && I2C
	help
	  Enhanced i2c shell with read/write running asynchronously via
	  shell_async worker threads.  All other commands (scan, recover,
	  speed, ...) remain synchronous.  Mutually exclusive with the
	  upstream CONFIG_I2C_SHELL — set CONFIG_I2C_SHELL=n when enabling
	  this option.

config QCOM_I2C_SHELL_BUFFER_SIZE
	int "I2C shell read/write buffer size (bytes)"
	depends on QCOM_I2C_SHELL
	default 128
	range 16 512
	help
	  Size of the per-operation data buffer allocated on the worker
	  thread stack for i2c read and write commands.

config QCOM_SPI_SHELL_BUFFER_SIZE
	int "SPI shell transfer buffer size (bytes)"
	depends on QCOM_SPI_SHELL
	default 4096
	help
	  Maximum payload size for the generic SPI shell TX/RX buffers.  Larger
	  values can be selected by applications that need large DMA transfers.

config QCOM_ACOMP_SHELL
	bool "QCOM comparator shell"
	depends on SHELL && COMPARATOR && GPIO
	help
	  Enable QCC74x comparator commands under "qcom acomp". Commands run in
	  a dedicated service thread to serialize comparator and optional
	  drive-GPIO access.

config QCOM_PSA_HASH_SHELL
	bool "PSA Hash shell commands"
	depends on SHELL
	depends on MBEDTLS_PSA_CRYPTO_C
	help
	  Enable interactive shell commands for PSA hash computation.
	  Provides 'hash oneshot/multipart/str-oneshot/str-multipart/list/help'
	  commands. Works with any active PSA hash backend (HW transparent
	  driver or SW fallback). Does not depend on a specific driver variant.

endmenu

rsource "Kconfig.pm"
```

## common/shell/Kconfig.pm
```kconfig
# Copyright (c) Qualcomm Technologies, Inc. and/or its subsidiaries
# SPDX-License-Identifier: BSD-3-Clause

menu "QCC74x Low Power Shell"

depends on SOC_SERIES_QCC74X && SHELL

config QCC74X_PM_SHELL
	bool
	default y if QCC74X_PM_PDS_VALIDATION || QCC74X_HBN_SHELL

config QCC74X_PM_PDS_VALIDATION
	bool "Enable QCC74x low-power PDS15 validation commands"
	depends on PM && QCC74X_PM_LPFW && QCC74X_PM_PDS15_POLICY
	depends on QCC74X_PM_DIAGNOSTICS
	default n
	help
	  Enable the qcom pm pds shell command group used to observe QCC74x
	  PDS15 low-power bring-up, run LPFW initialization, and inspect the
	  wake path from an application using the QCOM shell.

config QCC74X_PM_PDS_DEFAULT_SLEEP_MS
	int "Default low-power validation sleep duration in milliseconds"
	depends on QCC74X_PM_PDS_VALIDATION
	range 1 60000
	default 200

endmenu
```

## common/uart_edl/Kconfig
```kconfig
# Copyright (c) Qualcomm Technologies, Inc. and/or its subsidiaries.
# SPDX-License-Identifier: BSD-3-Clause

config QCC74X_UART_EDL_TRIGGER
	bool "QCC74x lightweight UART EDL trigger"
	depends on UART_INTERRUPT_DRIVEN
	depends on !SHELL
	help
	  Enables a minimal interrupt-driven UART listener that watches the
	  console UART for the string "platform reboot --edl\r\n" (23 bytes).
	  When the full string is matched the chip immediately calls
	  qc7xx_sys_reset_system_from_interface() to enter Emergency Download
	  mode, exactly as the shell "platform reboot --edl" command does.

	  Using the same trigger string as the shell command means the host
	  script (qconn_pre_flash.py) never needs to know whether the running
	  firmware has CONFIG_SHELL or CONFIG_QCC74X_UART_EDL_TRIGGER – it
	  always sends the same bytes:
	    python qconn_pre_flash.py COM7

	  IMPORTANT: This option is mutually exclusive with CONFIG_SHELL.
	  When CONFIG_SHELL=y the shell backend already owns the console UART
	  interrupt callback (uart_irq_callback_user_data_set).  Enabling
	  this option at the same time would silently override that callback,
	  breaking all shell input/output.

	  This saves approximately 30-50 KB of flash and 4-8 KB of RAM
	  compared to enabling the full shell subsystem.

	  Host side: send b"platform reboot --edl\r\n" over the serial port.
	  The same qconn_pre_flash.py script works for both shell and
	  no-shell firmware, with no extra flags needed.
```

## qcc74x_testing/samples/basic/blinky/sample.yaml
```yaml
# Copyright (c) 2026 Qualcomm Technologies, Inc. and/or its subsidiaries
# SPDX-License-Identifier: Apache-2.0
#
# Wrapper testcase for upstream zephyr/samples/basic/blinky.
# Uses harness: console (not harness: led) so device-testing is supported.

tests:
  qcc7xx.sample.basic.blinky:
    tags:
      - LED
      - gpio
    depends_on: gpio
    harness: console
    harness_config:
      type: multi_line
      ordered: false
      regex:
        - "LED state: ON"
        - "LED state: OFF"
    platform_allow:
      - qcc748m_evk/qcc748
      - qcc744m_evk/qcc744
      - qcc743m_evk/qcc743
    integration_platforms:
      - qcc748m_evk/qcc748
    timeout: 30
```

## qcc74x_testing/samples/basic/blinky_pwm/sample.yaml
```yaml
sample:
  name: Blinky using PWM
  description: Blink an LED using PWM

common:
  tags:
    - pwm
    - LED
  filter: dt_alias_exists("pwm-led0") and dt_compat_enabled("pwm-leds")
  depends_on: pwm

tests:
  sample.basic.blinky_pwm:
    harness: console
    harness_config:
      type: one_line
      regex:
        - "PWM-based blinky"
    platform_allow:
      - qcc748m_evk
```

## qcc74x_testing/samples/bluetooth/beacon/sample.yaml
```yaml
# Copyright (c) 2026 Qualcomm Technologies, Inc. and/or its subsidiaries
# SPDX-License-Identifier: BSD-3-Clause
#
# Wrapper testcase for upstream zephyr/samples/bluetooth/beacon.
# Uses harness: console so device-testing is supported without a BT harness.

tests:
  qcc7xx.sample.bluetooth.beacon:
    tags:
      - bluetooth
    depends_on: bluetooth
    harness: console
    harness_config:
      type: one_line
      regex:
        - "Beacon started, advertising as"
    platform_allow:
      - qcc748m_evk/qcc748
      - qcc744m_evk/qcc744
      - qcc743m_evk/qcc743
    integration_platforms:
      - qcc748m_evk/qcc748
    timeout: 60
```

## qcc74x_testing/samples/drivers/adc/adc_dt/sample.yaml
```yaml
# Copyright (c) 2026 Qualcomm Technologies, Inc. and/or its subsidiaries
# SPDX-License-Identifier: BSD-3-Clause

sample:
  name: QCC74x ADC devicetree DMA sample (project-owned)
common:
  tags:
    - adc
  depends_on: adc
  filter: dt_node_has_prop("/zephyr,user","io-channels")
  harness: console
  timeout: 10
  harness_config:
    type: multi_line
    regex:
      - "ADC reading\\[\\d+\\]:"
      - "- .+, channel \\d+: -?\\d+"
tests:
  qcc7xx.sample.drivers.adc.adc_dt.dma_74x:
    platform_allow:
      - qcc748m_evk/qcc748
```

## qcc74x_testing/samples/drivers/adc/adc_sequence/sample.yaml
```yaml
# Copyright (c) 2026 Qualcomm Technologies, Inc. and/or its subsidiaries
# SPDX-License-Identifier: BSD-3-Clause

sample:
  name: QCC74x ADC sequence DMA sample (project-owned)
common:
  tags:
    - adc
  depends_on: adc
  filter: dt_alias_exists("adc0")
  harness: console
  timeout: 10
  harness_config:
    type: multi_line
    regex:
      - "ADC sequence reading \\[\\d+\\]:"
      - "- .+, channel \\d+, \\d+ sequence samples:"
      - "- - \\d+ (= \\d+mV)|(\\(value in mV not available\\))"
tests:
  qcc7xx.sample.drivers.adc.adc_sequence.dma_74x:
    platform_allow:
      - qcc748m_evk/qcc748
```

## qcc74x_testing/samples/drivers/counter/alarm/Kconfig
```kconfig
# Copyright (c) 2019 Linaro Limited
# Copyright (c) 2026 Qualcomm Technologies, Inc. and/or its subsidiaries
# SPDX-License-Identifier: Apache-2.0

source "Kconfig.zephyr"
```

## qcc74x_testing/samples/drivers/counter/alarm/sample.yaml
```yaml
# Copyright (c) 2026 Qualcomm Technologies, Inc. and/or its subsidiaries
# SPDX-License-Identifier: BSD-3-Clause

sample:
  name: Counter alarm sample for QCC74x (project-owned copy)
common:
  tags:
    - counter
  timeout: 120
  harness: console
  harness_config:
    type: multi_line
    ordered: true
    regex:
      - "Counter alarm sample"
      - "Set alarm in 2 sec"
      - "!!! Alarm !!!"
      - "Set alarm in 4 sec"
      - "!!! Alarm !!!"
tests:
  qcc7xx.sample.drivers.counter.alarm:
    platform_allow:
      - qcc743m_evk
      - qcc744m_evk
      - qcc748m_evk
      - qcc75xm_evk
```

## qcc74x_testing/samples/drivers/counter/alarm_gpio_clk_src/boards/qcc75xm_evk.conf
```kconfig
CONFIG_LOG=y
CONFIG_LOG_MODE_IMMEDIATE=y
CONFIG_COUNTER_LOG_LEVEL_WRN=y
CONFIG_PWM=y
```

## qcc74x_testing/samples/drivers/counter/alarm_gpio_clk_src/sample.yaml
```yaml
# Copyright (c) 2026 Qualcomm Technologies, Inc. and/or its subsidiaries
# SPDX-License-Identifier: BSD-3-Clause

sample:
  name: Counter driver sample for Opal
common:
  tags:
    - counter
  timeout: 120
  harness: console
  harness_config:
    type: multi_line
    ordered: true
    regex:
      - "Counter alarm sample"
      - "Set alarm in 2 sec"
      - "!!! Alarm !!!"
      - "Set alarm in 4 sec"
      - "!!! Alarm !!!"
tests:
  qcc7xx.sample.drivers.counter.alarm_gpio_clk_src:
    platform_allow:
      - qcc748m_evk
      - qcc744m_evk
      - qcc743m_evk
      - qcc75xm_evk
```

## qcc74x_testing/samples/drivers/pinctrl/qcom/testcase.yaml
```yaml
# Copyright (c) 2026 Qualcomm Technologies, Inc. and/or its subsidiaries
# SPDX-License-Identifier: BSD-3-Clause

common:
  tags:
    - drivers
    - pinctrl
  harness: ztest
  extra_dtc_overlay_files:
    - "boards/${BOARD}.overlay"
  platform_allow:
    - qcc743m_evk
    - qcc744m_evk
    - qcc748m_evk

tests:
  drivers.pinctrl.qcom: {}
```

## qcc74x_testing/samples/drivers/uart/async_api/boards/qcc743m_evk.conf
```kconfig
# Copyright (c) 2026 Qualcomm Technologies, Inc. and/or its subsidiaries
# SPDX-License-Identifier: BSD-3-Clause

CONFIG_DMA=y
CONFIG_SYSTEM_WORKQUEUE_STACK_SIZE=8192
CONFIG_MAIN_STACK_SIZE=8192
CONFIG_LOG_BUFFER_SIZE=8192
CONFIG_KERNEL_LOG_LEVEL_OFF=y
CONFIG_MPU_LOG_LEVEL_OFF=y
CONFIG_UART_INTERRUPT_DRIVEN=y
```
