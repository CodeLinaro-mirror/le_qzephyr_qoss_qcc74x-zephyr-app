/*
 * Copyright (c) Qualcomm Technologies, Inc. and/or its subsidiaries.
 * All rights reserved.
 * Confidential and Proprietary - Qualcomm Technologies, Inc.
 *
 * Contains code under the following license:
 *
 * Not a contribution.
 *
 * Copyright (c) Zephyr Project members and individual contributors.
 * SPDX-License-Identifier: Apache-2.0
 */


#include "qcc74xm_evk_common.dtsi"

&pinctrl {
	i2s0_default: i2s0_default {
		group1 {
			pinmux = <GPIO16_I2S_BCLK>,
				 <GPIO17_I2S_FS>,
				 <GPIO18_I2S_DI>,
				 <GPIO19_I2S_DO>;
			input-enable;
		};
	};
};
